## CMakeLists.txt
```
# SPDX-License-Identifier: Apache-2.0

cmake_minimum_required(VERSION 3.20.0)

# Use the local memfault-firmware-sdk from this repository instead of cloning
# it via west.
if(NOT DEFINED ENV{MEMFAULT_SDK_DIR})
    set(ENV{MEMFAULT_SDK_DIR} ${CMAKE_CURRENT_LIST_DIR}/../../../../)
endif()
list(APPEND ZEPHYR_EXTRA_MODULES $ENV{MEMFAULT_SDK_DIR}/ports)

find_package(Zephyr REQUIRED HINTS $ENV{ZEPHYR_BASE})
project(test-app)

target_sources(app PRIVATE
    src/main.c
    src/test_platform_http.c
    src/test_http_response_codes.c
)
```

## prj.conf
```kconfig
CONFIG_ZTEST=y
CONFIG_MEMFAULT=y

# Basic Networking Support
CONFIG_NETWORKING=y
CONFIG_NET_IPV4=y
CONFIG_NET_TCP=y
CONFIG_NET_TEST=y
CONFIG_NET_SOCKETS=y
CONFIG_NET_SOCKETS_SOCKOPT_TLS=y

# Socketpair support (used by test_http_response_codes.c)
CONFIG_NET_SOCKETPAIR=y
# Large enough to hold the outgoing HTTP request headers + chunk data without blocking
CONFIG_NET_SOCKETPAIR_BUFFER_SIZE=1024

# Network Testing
CONFIG_TEST_RANDOM_GENERATOR=y

# Network Configuration
# CONFIG_NET_CONFIG_MY_IPV4_ADDR="192.0.2.1"
# CONFIG_NET_CONFIG_PEER_IPV4_ADDR="192.0.2.2"

# Memory Configuration
CONFIG_HEAP_MEM_POOL_SIZE=30000

# Memfault Configuration
CONFIG_MEMFAULT_HTTP_ENABLE=y
CONFIG_MEMFAULT_PROJECT_KEY="dummy"
# Disable for testing purposes (mocks are used instead of TLS_CREDENTIAL_STORAGE
# backend)
CONFIG_MEMFAULT_ROOT_CERT_STORAGE=n

# MbedTLS Configuration
CONFIG_MBEDTLS=y
CONFIG_MBEDTLS_SHA1=y
CONFIG_MBEDTLS_SERVER_NAME_INDICATION=y
```

## boards/native_sim.conf
```kconfig
CONFIG_ASAN=y
CONFIG_UBSAN=y
```

## src/main.c
```c
//! @file
//!
//! Copyright (c) Memfault, Inc.
//! See LICENSE for details

#include <zephyr/ztest.h>

// Main test entry point - can be left empty if using ZTEST_SUITE
```

## src/test_http_response_codes.c
```c
//! @file
//!
//! Copyright (c) Memfault, Inc.
//! See LICENSE for details
//!
//! Tests for prv_wait_for_http_response returning the HTTP status code.
//! Verifies that any 2xx HTTP response is treated as success, and non-2xx
//! responses are treated as failures by memfault_zephyr_port_http_post_chunk.

#include <string.h>
#include <zephyr/net/socket.h>
#include <zephyr/ztest.h>

#include "memfault/core/platform/device_info.h"
#include "memfault/ports/zephyr/http.h"

// Override the weak default so memfault_http_start_chunk_post can build the request URI.
void memfault_platform_get_device_info(sMemfaultDeviceInfo *info) {
  *info = (sMemfaultDeviceInfo){
    .device_serial = "test-device",
    .software_type = "main",
    .software_version = "1.0.0",
    .hardware_version = "dvt",
  };
}

//! Helper that creates a socketpair, writes @p http_response to the remote end, then calls
//! memfault_zephyr_port_http_post_chunk and returns its return value.
//!
//! The HTTP response is pre-written to fds[1] so that prv_wait_for_http_response can read it
//! from fds[0] without blocking. Outgoing request bytes written to fds[0] land in fds[1]'s
//! receive buffer; CONFIG_NET_SOCKETPAIR_BUFFER_SIZE must be large enough to absorb them.
static int prv_post_chunk_with_response(const char *http_response) {
  int fds[2];
  zassert_equal(zsock_socketpair(AF_UNIX, SOCK_STREAM, 0, fds), 0, "socketpair failed");

  // Stage the response on fds[1]; memfault_zephyr_port_http_post_chunk will read it from fds[0].
  // Loop to handle partial sends - zsock_send() on a stream socket may write fewer bytes than
  // requested.
  const size_t response_len = strlen(http_response);
  size_t total_sent = 0;
  while (total_sent < response_len) {
    const ssize_t sent =
      zsock_send(fds[1], http_response + total_sent, response_len - total_sent, 0);
    zassert_true(sent > 0, "send failed");
    total_sent += (size_t)sent;
  }

  sMemfaultHttpContext ctx = { .sock_fd = fds[0] };
  uint8_t chunk_data[] = { 0x01, 0x02, 0x03 };
  const int rv = memfault_zephyr_port_http_post_chunk(&ctx, chunk_data, sizeof(chunk_data));

  zsock_close(fds[0]);
  zsock_close(fds[1]);
  return rv;
}

ZTEST(memfault_http_response_codes, test_post_chunk_200_response) {
  const int rv = prv_post_chunk_with_response("HTTP/1.1 200 OK\r\nContent-Length: 0\r\n\r\n");
  zassert_equal(rv, 0, "Expected 0 for 200 response, got %d", rv);
}

ZTEST(memfault_http_response_codes, test_post_chunk_201_response) {
  const int rv = prv_post_chunk_with_response("HTTP/1.1 201 Created\r\nContent-Length: 0\r\n\r\n");
  zassert_equal(rv, 0, "Expected 0 for 201 response, got %d", rv);
}

ZTEST(memfault_http_response_codes, test_post_chunk_202_response) {
  const int rv = prv_post_chunk_with_response("HTTP/1.1 202 Accepted\r\nContent-Length: 0\r\n\r\n");
  zassert_equal(rv, 0, "Expected 0 for 202 response, got %d", rv);
}

ZTEST(memfault_http_response_codes, test_post_chunk_non_2xx_response) {
  const int rv =
    prv_post_chunk_with_response("HTTP/1.1 429 Too Many Requests\r\nContent-Length: 0\r\n\r\n");
  zassert_equal(rv, -3, "Expected -3 for 429 response, got %d", rv);
}

ZTEST_SUITE(memfault_http_response_codes, NULL, NULL, NULL, NULL, NULL);
```

## src/test_platform_http.c
```c
//! @file
//!
//! Copyright (c) Memfault, Inc.
//! See LICENSE for details

#include <string.h>
#include <zephyr/ztest.h>

#include "memfault/http/root_certs.h"
#include "memfault/ports/zephyr/deprecated_root_cert.h"
#include "memfault/ports/zephyr/http.h"
#include "memfault/ports/zephyr/root_cert_storage.h"

typedef struct {
  eMemfaultRootCert cert_id;
  const char *cert;
  size_t cert_len;
} sCertAddCall;

static sCertAddCall s_add_calls[4];
static size_t s_add_call_count;

static eMemfaultRootCert s_remove_calls[4];
static size_t s_remove_call_count;

int memfault_root_cert_storage_add(eMemfaultRootCert cert_id, const char *cert,
                                   size_t cert_length) {
  zassert_true(s_add_call_count < ARRAY_SIZE(s_add_calls), "Too many add calls");

  s_add_calls[s_add_call_count].cert_id = cert_id;
  s_add_calls[s_add_call_count].cert = cert;
  s_add_calls[s_add_call_count].cert_len = cert_length;
  s_add_call_count++;
  return 0;
}

int memfault_root_cert_storage_remove(eMemfaultRootCert cert_id) {
  zassert_true(s_remove_call_count < ARRAY_SIZE(s_remove_calls), "Too many remove calls");

  s_remove_calls[s_remove_call_count++] = cert_id;
  return 0;
}

static void *setup_test(void) {
  memset(s_add_calls, 0, sizeof(s_add_calls));
  s_add_call_count = 0;
  memset(s_remove_calls, 0, sizeof(s_remove_calls));
  s_remove_call_count = 0;
  return NULL;
}

ZTEST(memfault_platform_http, test_install_root_certs) {
  const int rv = memfault_zephyr_port_install_root_certs();
  zassert_equal(rv, 0, "Expected root cert installation to succeed");

  // Deprecated certs are removed first, followed by the certs for the inactive endpoint type
#if defined(CONFIG_MEMFAULT_HTTP_USE_ECDSA_ENDPOINTS)
  static const eMemfaultRootCert expected_unused_remove_ids[] = {
    kMemfaultRootCert_DigicertRootG2,
    kMemfaultRootCert_AmazonRootCa1,
  };
#else
  static const eMemfaultRootCert expected_unused_remove_ids[] = {
    kMemfaultRootCert_DigicertTlsEccP384RootG5,
  };
#endif
  const size_t expected_deprecated_remove_count =
    (size_t)(kMemfaultDeprecatedRootCert_MaxIndex - kMemfaultDeprecatedRootCert_DigicertRootCa);
  const size_t expected_remove_count =
    expected_deprecated_remove_count + ARRAY_SIZE(expected_unused_remove_ids);
  zassert_equal(s_remove_call_count, expected_remove_count, "Unexpected number of remove calls");

  for (size_t i = 0; i < expected_deprecated_remove_count; i++) {
    const eMemfaultRootCert expected_id =
      (eMemfaultRootCert)(kMemfaultDeprecatedRootCert_DigicertRootCa + i);
    zassert_equal(s_remove_calls[i], expected_id, "Unexpected cert id removed at index %d", (int)i);
  }
  for (size_t i = 0; i < ARRAY_SIZE(expected_unused_remove_ids); i++) {
    const size_t idx = expected_deprecated_remove_count + i;
    zassert_equal(s_remove_calls[idx], expected_unused_remove_ids[i],
                  "Unexpected cert id removed at index %d", (int)idx);
  }

#if defined(CONFIG_MEMFAULT_HTTP_USE_ECDSA_ENDPOINTS)
  static const eMemfaultRootCert expected_add_ids[] = {
    kMemfaultRootCert_DigicertTlsEccP384RootG5,
  };

  #if defined(CONFIG_MEMFAULT_TLS_CERTS_USE_DER)
  static const uint8_t *const expected_add_certs[] = {
    g_memfault_cert_digicert_tls_ecc_p384_root_g5,
  };
  size_t expected_add_cert_lens[1];
  expected_add_cert_lens[0] = g_memfault_cert_digicert_tls_ecc_p384_root_g5_len;
  #elif defined(CONFIG_MEMFAULT_TLS_CERTS_USE_PEM)
  static const uint8_t *const expected_add_certs[] = {
    (const uint8_t *)MEMFAULT_ROOT_CERTS_DIGICERT_TLS_ECC_P384_ROOT_G5,
  };
  static const size_t expected_add_cert_lens[] = {
    sizeof(MEMFAULT_ROOT_CERTS_DIGICERT_TLS_ECC_P384_ROOT_G5),
  };
  #else
    #error "Unsupported cert format"
  #endif
#else
  static const eMemfaultRootCert expected_add_ids[] = {
    kMemfaultRootCert_DigicertRootG2,
    kMemfaultRootCert_AmazonRootCa1,
  };

  #if defined(CONFIG_MEMFAULT_TLS_CERTS_USE_DER)
  static const uint8_t *const expected_add_certs[] = {
    g_memfault_cert_digicert_global_root_g2,
    g_memfault_cert_amazon_root_ca1,
  };
  size_t expected_add_cert_lens[2];
  expected_add_cert_lens[0] = g_memfault_cert_digicert_global_root_g2_len;
  expected_add_cert_lens[1] = g_memfault_cert_amazon_root_ca1_len;
  #elif defined(CONFIG_MEMFAULT_TLS_CERTS_USE_PEM)
  static const uint8_t *const expected_add_certs[] = {
    (const uint8_t *)MEMFAULT_ROOT_CERTS_DIGICERT_GLOBAL_ROOT_G2,
    (const uint8_t *)MEMFAULT_ROOT_CERTS_AMAZON_ROOT_CA1,
  };
  static const size_t expected_add_cert_lens[] = {
    sizeof(MEMFAULT_ROOT_CERTS_DIGICERT_GLOBAL_ROOT_G2),
    sizeof(MEMFAULT_ROOT_CERTS_AMAZON_ROOT_CA1),
  };
  #else
    #error "Unsupported cert format"
  #endif
#endif

  zassert_equal(s_add_call_count, ARRAY_SIZE(expected_add_ids), "Unexpected number of add calls");

  for (size_t i = 0; i < ARRAY_SIZE(expected_add_ids); i++) {
    zassert_equal(s_add_calls[i].cert_id, expected_add_ids[i],
                  "Unexpected cert id added at index %d", (int)i);
    zassert_equal(s_add_calls[i].cert_len, expected_add_cert_lens[i],
                  "Unexpected cert length at index %d", (int)i);
    zassert_mem_equal(s_add_calls[i].cert, expected_add_certs[i], expected_add_cert_lens[i],
                      "Unexpected cert contents at index %d", (int)i);
  }
}

ZTEST_SUITE(memfault_platform_http, NULL, setup_test, NULL, NULL, NULL);
```
