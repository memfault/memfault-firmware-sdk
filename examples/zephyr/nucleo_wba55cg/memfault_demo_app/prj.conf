## CMakeLists.txt
```
cmake_minimum_required(VERSION 3.13.1)

find_package(Zephyr REQUIRED HINTS $ENV{ZEPHYR_BASE})
project(memfault_demo_app)

zephyr_include_directories(config)
target_sources(app PRIVATE src/main.c)
```

## west.yml
```
# West manifest for Memfault Example Application

manifest:
  remotes:
    - name: zephyrproject-rtos
      url-base: https://github.com/zephyrproject-rtos

  projects:
    - name: zephyr
      remote: zephyrproject-rtos
      revision: v3.7.0
      import:
        # Limit the Zephyr modules to the required set
        name-allowlist:
          - cmsis
          - hal_stm32
          - picolibc
          - tinycrypt

    - name: memfault-firmware-sdk
      path: modules/lib/memfault-firmware-sdk
      url: https://github.com/memfault/memfault-firmware-sdk
      # Memfault recommends pinning to a specific release tag for production
      revision: master
```

## prj.conf
```kconfig
# General config
CONFIG_SHELL=y

CONFIG_LOG=y
# CONFIG_LOG_BACKEND_UART=y ensures logs (and printk's, because of
# CONFIG_LOG_PRINTK=y) are available before the console thread is started.
CONFIG_LOG_BACKEND_UART=y
# Logs are going to the UART directly, don't need to also emit them to the shell
CONFIG_SHELL_LOG_BACKEND=n
CONFIG_LOG_MODE_IMMEDIATE=y

# To catch stack overflows at the point of overflow
CONFIG_MPU_STACK_GUARD=y

# Memfault configuration
CONFIG_MEMFAULT=y

# Enable asserts, now that Memfault is enabled to catch crashes
CONFIG_ASSERT=y

CONFIG_BT=y
CONFIG_LOG=y
CONFIG_BT_SMP=y
CONFIG_BT_PERIPHERAL=y
CONFIG_BT_DIS=y
CONFIG_BT_DIS_PNP=n
CONFIG_BT_BAS=y
CONFIG_BT_HRS=y
CONFIG_BT_DEVICE_NAME="Memfault Sample App"
CONFIG_BT_DEVICE_APPEARANCE=833

CONFIG_BT_SHELL=y
```

## src/main.c
```c
//! @file
//!
//! Copyright (c) Memfault, Inc.
//! See LICENSE for details

#include <string.h>
#include <zephyr/devicetree.h>
#include <zephyr/drivers/gpio.h>
#include <zephyr/kernel.h>
#include <zephyr/logging/log.h>

#include "memfault/components.h"
#include "memfault/ports/zephyr/http.h"

LOG_MODULE_REGISTER(mflt_app, LOG_LEVEL_DBG);

// Blink code taken from the zephyr/samples/basic/blinky example.

static void blink_forever(void) {
/* 1000 msec = 1 sec */
#define SLEEP_TIME_MS 1000

/* The devicetree node identifier for the "led0" alias. */
#define LED0_NODE DT_ALIAS(led0)

  static const struct gpio_dt_spec led = GPIO_DT_SPEC_GET(LED0_NODE, gpios);

  int ret = gpio_pin_configure_dt(&led, GPIO_OUTPUT_ACTIVE);
  if (ret < 0) {
    return;
  }

  while (1) {
    gpio_pin_toggle_dt(&led);
    k_msleep(SLEEP_TIME_MS);
  }
}

// put the blink_forever in its own thread.
K_THREAD_DEFINE(blink_forever_thread, 1024, blink_forever, NULL, NULL, NULL, K_PRIO_PREEMPT(8), 0,
                0);

int main(void) {
  printk(MEMFAULT_BANNER_COLORIZED "\n");

  LOG_INF("Memfault Demo App! Board %s\n", CONFIG_BOARD);
  memfault_device_info_dump();

  return 0;
}
```
