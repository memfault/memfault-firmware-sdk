## CMakeLists.txt
```
# SPDX-License-Identifier: Apache-2.0

cmake_minimum_required(VERSION 3.20.0)

# The default board for this example is the nrf52840dk/nrf52840, but can be
# overridden by passing --board=<board> to west or -DBOARD=<board> to cmake
set(BOARD nrf52840dk/nrf52840)

# We need the nRF Connect SDK version before loading Zephyr, to dynamically
# select Kconfig overlays based on version- not something that can be achieved
# with Zephyr today.
#
# Note: previously this was done with 'find_package(Ncs)', but as of sdk-nrf
# commit 40f7487d3a ("cmake: adopt VERSION to common VERSION file format"),
# NcsConfig.cmake requires ZEPHYR_BASE to be set, which is not available before
# 'find_package(Zephyr)'. Instead, read the version directly from the VERSION
# file, supporting both formats:
# - nRF Connect SDK <= v3.3.0: single line, "<major>.<minor>.<patch>[-extra]"
# - newer: Zephyr-style "VERSION_MAJOR = <major>" etc. key-value lines
set(NCS_VERSION_FILE "$ENV{ZEPHYR_BASE}/../nrf/VERSION")
if(EXISTS "${NCS_VERSION_FILE}")
  file(READ "${NCS_VERSION_FILE}" ncs_version_content)
  if(ncs_version_content MATCHES "VERSION_MAJOR *= *([0-9]+)")
    set(NCS_VERSION_MAJOR ${CMAKE_MATCH_1})
    string(REGEX MATCH "VERSION_MINOR *= *([0-9]+)" _ "${ncs_version_content}")
    set(NCS_VERSION_MINOR ${CMAKE_MATCH_1})
    string(REGEX MATCH "PATCHLEVEL *= *([0-9]+)" _ "${ncs_version_content}")
    set(NCS_VERSION_PATCH ${CMAKE_MATCH_1})
  elseif(ncs_version_content MATCHES "([0-9]+)\\.([0-9]+)\\.([0-9]+)")
    set(NCS_VERSION_MAJOR ${CMAKE_MATCH_1})
    set(NCS_VERSION_MINOR ${CMAKE_MATCH_2})
    set(NCS_VERSION_PATCH ${CMAKE_MATCH_3})
  endif()
endif()

# Confirm NCS_VERSION_MAJOR is defined
if (NOT DEFINED NCS_VERSION_MAJOR)
  message(FATAL_ERROR "NCS Version not found, please contact Memfault support!")
endif()

# Below we conditionally set Kconfig variables via overlays based on nRF Connect SDK version
# (since setting non-existent variables result in a build time error which
# would break compiling older builds)

if (${NCS_VERSION_MAJOR}.${NCS_VERSION_MINOR}.${NCS_VERSION_PATCH} VERSION_LESS 3.2.0)
set(OVERLAY_CONFIG "${OVERLAY_CONFIG};overlays/ncs-pre-v3.2.0.conf")
endif()

if (${NCS_VERSION_MAJOR}.${NCS_VERSION_MINOR}.${NCS_VERSION_PATCH} VERSION_GREATER_EQUAL 3.3.0)
set(OVERLAY_CONFIG "${OVERLAY_CONFIG};overlays/ncs-v3.3.0.conf")
endif()

find_package(Zephyr REQUIRED HINTS $ENV{ZEPHYR_BASE})
project(fs_shell)

FILE(GLOB app_sources src/*.c)
target_sources(app PRIVATE
  src/main.c
  src/shell_commands.c
)

zephyr_include_directories(config)

# Normalize dbug + __FILE__ paths to relative locations:
# 1. west workspace
# 2. toolchain install location (applies to paths in cross tool library files)
#
# If debugging from location 1., the west-manifest files should already have the
# correct relative path for GDB to locate them, otherwise the GDB "directory"
# command can be used to tell GDB where to find the source files (also required
# if the cross tool libraries/headers need to be located by GDB)
get_filename_component(WEST_PROJECT_ROOT_PATH
                       "${CMAKE_CURRENT_LIST_DIR}/.."
                       ABSOLUTE)
zephyr_compile_options(
    -ffile-prefix-map=${WEST_PROJECT_ROOT_PATH}=.
    -ffile-prefix-map=${TOOLCHAIN_HOME}=.
    -Wa,--debug-prefix-map=${WEST_PROJECT_ROOT_PATH}=.
)

# If building for nrf54l15dk, add a custom linker fragment for placing the
# noinit section.
if(CONFIG_BOARD_NRF54L15DK)
  zephyr_linker_sources(SECTIONS
    ${CMAKE_CURRENT_SOURCE_DIR}/boards/nrf54l15dk_nrf54l15_cpuapp_noinit.ld
  )
endif()

# Same for nrf54lm20DK
if(CONFIG_BOARD_NRF54LM20DK)
  zephyr_linker_sources(SECTIONS
    ${CMAKE_CURRENT_SOURCE_DIR}/boards/nrf54lm20dk_nrf54lm20a_cpuapp_noinit.ld
  )
endif()
```

## Kconfig
```
menu "MEMFAULT_APP"

# Set Memfault software_version from the VERSION file in the application. This
# is also used by MCUBoot to set CONFIG_MCUBOOT_IMGTOOL_SIGN_VERSION, so the
# MCUBoot image version will match the Memfault-reported version with this
# setting. Note: the Kconfig flag MEMFAULT_NCS_FW_VERSION is defined in the NCS
# repo, here it's just overriding the default string to be set to the desired value.
config MEMFAULT_NCS_FW_VERSION
	default "$(APP_VERSION_TWEAK_STRING)"

config MEMFAULT_APP_CAPTURE_ALL_RAM
	bool "Capture all RAM"
	help
	  Capture all RAM regions. This is useful for debugging purposes, but
	  will increase the amount of data captured by the Memfault SDK.

# If MEMFAULT_APP_CAPTURE_ALL_RAM is enabled, increase the configured space
# for the Memfault storage partition to accommodate the larger coredump.
#
# This overrides the default setting, which can be found here:
# https://github.com/nrfconnect/sdk-nrf/blob/96f97684565fbf711f1ceb7da061fed0bfe7b60b/modules/memfault-firmware-sdk/Kconfig#L170-L172
#
# Expanded into the template here:
# https://github.com/nrfconnect/sdk-nrf/blob/96f97684565fbf711f1ceb7da061fed0bfe7b60b/subsys/partition_manager/Kconfig.template.partition_size
#
# Keep 'source "Kconfig.zephyr"' at the end of this file so this default takes
# precedence.
if MEMFAULT_NCS_INTERNAL_FLASH_BACKED_COREDUMP
config PM_PARTITION_SIZE_MEMFAULT_STORAGE
	hex "Size of the Memfault storage partition"
	# The default size is set to one page above the total RAM size on the
	# NRF52840 SOC, which provides room for the coredump header and NVIC and CPU
	# registers. This size needs to be flash page-aligned ("minimum eraseable
	# unit").
	default 0x41000 if MEMFAULT_APP_CAPTURE_ALL_RAM
endif
endmenu

#
# Copyright (c) 2024 Nordic Semiconductor
#
# SPDX-License-Identifier: LicenseRef-Nordic-5-Clause
#

config SETTINGS
	default y

config ZMS
	default y if (SOC_FLASH_NRF_RRAM || SOC_FLASH_NRF_MRAM)

config NVS
	default y if !(SOC_FLASH_NRF_RRAM || SOC_FLASH_NRF_MRAM)

### Memfault Device Identification settings ###
#
# There are 3 places device identification is used:
#
# | Field             | Memfault (NCS)          | Bluetooth DIS            | MCUboot                      |
# |-------------------|-------------------------|--------------------------|------------------------------|
# | .software_version | MEMFAULT_NCS_FW_VERSION | BT_DIS_FW_REV_STR        | MCUBOOT_IMGTOOL_SIGN_VERSION |
# | .software_type    | MEMFAULT_NCS_FW_TYPE    | BT_DIS_SW_REV_STR        | N/A                          |
# | .hardware_version | MEMFAULT_NCS_HW_VERSION | BT_DIS_HW_REV_STR        | N/A                          |
# | .device_serial    | MEMFAULT_NCS_DEVICE_ID  | BT_DIS_SERIAL_NUMBER_STR | N/A                          |
#
# How each is used:
# - Memfault uses these values to tag telemetry data sent to the Memfault cloud.
# - The Bluetooth Device Information Service (DIS) exposes these values over
#   BLE. These are used by the nRF Connect Device Manager app to execute FOTA
#   with nRF Cloud (Memfault). These values are required when performing the
#   FOTA requests.
# - MCUboot contains the .software_version in the image header, mostly used for
#   informational purposes.
#
# We use this Kconfig override file to set all 3 places simultaneously to ensure
# consistency.

# .software_version
config MEMFAULT_NCS_FW_VERSION
	# The MEMFAULT_BUILTIN_DEVICE_INFO_SOFTWARE_VERSION default uses the VERSION
	# file for the software version value
	default MEMFAULT_BUILTIN_DEVICE_INFO_SOFTWARE_VERSION
config MCUBOOT_IMGTOOL_SIGN_VERSION
	default MEMFAULT_NCS_FW_VERSION
config BT_DIS_FW_REV_STR
	default MEMFAULT_NCS_FW_VERSION

# .software_type
config MEMFAULT_NCS_FW_TYPE
	# Defaults to "app"
	default MEMFAULT_BUILTIN_DEVICE_INFO_SOFTWARE_TYPE
config BT_DIS_SW_REV_STR
	default MEMFAULT_NCS_FW_TYPE

# .hardware_version
config BT_DIS_HW_REV_STR
	default MEMFAULT_NCS_HW_VERSION

source "Kconfig.zephyr"
```

## Kconfig.sysbuild
```
source "share/sysbuild/Kconfig"

config NRF_DEFAULT_IPC_RADIO
	default y
```

## west.yml
```
manifest:
  remotes:
    - name: nrf-connect-sdk
      url-base: https://github.com/nrfconnect
  projects:
    - name: nrf
      url: https://github.com/nrfconnect/sdk-nrf
      revision: v3.4.1
      import: true

    # Adding the memfault-firmware-sdk module here overrides the version the nRF
    # Connect SDK would normally import above
    - name: memfault-firmware-sdk
      url: https://github.com/memfault/memfault-firmware-sdk
      path: modules/lib/memfault-firmware-sdk
      revision: master
  self:
    path: memfault_demo_app
```

## prj.conf
```kconfig
# Heap memory is required for the memfault_demo_cli.c
CONFIG_HEAP_MEM_POOL_SIZE=256

CONFIG_MAIN_STACK_SIZE=4096

CONFIG_BT=y
# Disabling bonding makes for simpler testing, but is not recommended for
# production.
CONFIG_BT_SMP=n
CONFIG_BT_PERIPHERAL=y
CONFIG_BT_DEVICE_NAME="Nordic_Memfault"
# Allows a name provisioned over the `bt name <name>` shell command (settings
# key bt/name) to override the build-time default above, applied on the next
# boot.
CONFIG_BT_DEVICE_NAME_DYNAMIC=y
CONFIG_BT_PRIVACY=y
CONFIG_BT_SHELL=y

CONFIG_BT_BAS=y
CONFIG_BT_MDS=y

# Max MTU + have the device initiate the ATT MTU exchange itself on connect
# rather than relying on the central to do it.
CONFIG_BT_CTLR_PHY_2M=y
CONFIG_BT_BUF_ACL_RX_SIZE=251
CONFIG_BT_L2CAP_TX_MTU=247
CONFIG_BT_BUF_ACL_TX_SIZE=251
CONFIG_BT_CTLR_DATA_LENGTH_MAX=251
CONFIG_BT_GATT_CLIENT=y
CONFIG_BT_GATT_AUTO_UPDATE_MTU=y

CONFIG_LOG=y
CONFIG_LOG_PRINTK=n
CONFIG_LOG_DEFAULT_LEVEL=2
CONFIG_LOG_MODE_DEFERRED=y
CONFIG_LOG_MODE_OVERFLOW=y
CONFIG_LOG_BACKEND_RTT=n

CONFIG_SHELL=y
CONFIG_SENSOR_SHELL=n
CONFIG_DK_LIBRARY=y

CONFIG_MEMFAULT=y
CONFIG_MEMFAULT_SHELL=y
CONFIG_MEMFAULT_LOG_LEVEL_INF=y

CONFIG_MEMFAULT_SYSTEM_TIME_SOURCE_CUSTOM=y

CONFIG_BT_SETTINGS=y
CONFIG_FLASH=y
CONFIG_FLASH_PAGE_LAYOUT=y
CONFIG_FLASH_MAP=y

# Enable OTA updates
CONFIG_NCS_SAMPLE_MCUMGR_BT_OTA_DFU=y

# Fill in with a Memfault Project Key
CONFIG_MEMFAULT_NCS_PROJECT_KEY="xxxxxxxxxxxxxxxxxxxxxxxxxxxxxxxx"

# Memfault firmware identification
CONFIG_MEMFAULT_NCS_FW_VERSION_STATIC=y

# Enable HW ID library to get device ID from UID
CONFIG_HW_ID_LIBRARY=y
CONFIG_HW_ID_LIBRARY_SOURCE_DEVICE_ID=y

# Enable more fields in the nRF Connect Device Manager app view
CONFIG_MCUMGR_GRP_OS_INFO=y

# Setting shell, useful for testing
CONFIG_SETTINGS_SHELL=y

# Settings runtime enables applying settings immediately without reboot
CONFIG_SETTINGS_RUNTIME=y

# `kernel reboot cold`, useful after provisioning a new device name via the
# settings shell (`bt name <name>`), which is applied on next boot.
CONFIG_REBOOT=y
CONFIG_KERNEL_SHELL=y

# Enable Flash and Bootloader components for flash-backed coredump storage
CONFIG_BOOTLOADER_MCUBOOT=y
CONFIG_MCUBOOT_IMG_MANAGER=y
CONFIG_IMG_MANAGER=y
CONFIG_STREAM_FLASH=y

CONFIG_WATCHDOG=y

# Enable Zephyr runtime asserts
CONFIG_ASSERT=y

# For testing poweroff mode, enable GPIO + poweroff subsystems
CONFIG_GPIO=y
CONFIG_POWEROFF=y
```

## boards/nrf54h20dk_nrf54h20_cpuapp.conf
```kconfig
# Use MRAM internal storage implementation instead of flash-based
CONFIG_MEMFAULT_NCS_INTERNAL_FLASH_BACKED_COREDUMP=n
CONFIG_MEMFAULT_COREDUMP_STORAGE_NRF_MRAM=y

# Enable Zephyr Power Management so the "pm_suspend_to_idle" shell command
# and the power_*_time_ms Memfault metrics can be exercised on this board.
CONFIG_PM=y
```

## boards/nrf54l15dk_nrf54l15_cpuapp.conf
```kconfig
# Use RRAM internal storage implementation instead of flash-based
CONFIG_MEMFAULT_NCS_INTERNAL_FLASH_BACKED_COREDUMP=n
CONFIG_MEMFAULT_COREDUMP_STORAGE_NRF_RRAM=y

# Place the noinit objects into a custom section.
CONFIG_MEMFAULT_REBOOT_TRACKING_REGION="memfault_noinit.memfault_reboot_info"
```

## boards/nrf54lm20dk_nrf54lm20a_cpuapp.conf
```kconfig
# Use RRAM internal storage implementation instead of flash-based
CONFIG_MEMFAULT_NCS_INTERNAL_FLASH_BACKED_COREDUMP=n
CONFIG_MEMFAULT_COREDUMP_STORAGE_NRF_RRAM=y

# Place the noinit objects into a custom section.
CONFIG_MEMFAULT_REBOOT_TRACKING_REGION="memfault_noinit.memfault_reboot_info"
CONFIG_MEMFAULT_RAM_BACKED_COREDUMP_REGION="memfault_noinit.memfault_coredump"
```

## 1mbaud_uart.overlay
```dts
/* gotta go fast 🐎 */
&uart0 {
	current-speed = <1000000>;
};
```

## boards/nrf54h20dk_nrf54h20_cpuapp.overlay
```dts
/*
 Adjust the fixed partitions in MRAM1 to add a 'memfault_coredump' partition
 for storing coredumps when using MRAM-backed coredump storage.
*/

&mram1x {
	partitions {
		storage_partition: partition@1a4000 {
			reg = <0x1a4000 DT_SIZE_K(20)>;
		};
		memfault_coredump_partition: partition@1a9000 {
			reg = <0x1a9000 DT_SIZE_K(20)>;
		};
	};
};
```

## boards/nrf54l15dk_nrf54l15_cpuapp.overlay
```dts
/* As of NCS v3.4.0, this board's flash layout is defined natively in
 * devicetree (upstream Zephyr board support) rather than via the Partition
 * Manager, and it leaves no spare space for a Memfault coredump partition.
 * Carve one out of the tail of storage_partition instead.
 */
&cpuapp_rram {
	partitions {
		/* Nordic's native partition layout omits this compatible, but the
		 * Memfault SDK's DT_HAS_FIXED_PARTITION_LABEL() lookup requires it.
		 */
		compatible = "fixed-partitions";

		storage_partition: partition@174000 {
			reg = <0x174000 0x8000>;
		};

		memfault_coredump_partition: partition@17c000 {
			compatible = "zephyr,mapped-partition";
			label = "memfault_coredump_partition";
			reg = <0x17c000 0x1000>;
		};
	};
};
```

## src/main.c
```c
/*
 * Copyright (c) 2022 Nordic Semiconductor ASA
 *
 * SPDX-License-Identifier: LicenseRef-Nordic-5-Clause
 */

#include <bluetooth/services/mds.h>
#include <dk_buttons_and_leds.h>
#include <memfault/components.h>
#include <memfault/core/trace_event.h>
#include <memfault/metrics/metrics.h>
#include <memfault/ports/watchdog.h>
#include <string.h>
#include <zephyr/bluetooth/bluetooth.h>
#include <zephyr/bluetooth/conn.h>
#include <zephyr/bluetooth/hci.h>
#include <zephyr/bluetooth/services/bas.h>
#include <zephyr/kernel.h>
#include <zephyr/settings/settings.h>
#include <zephyr/shell/shell.h>

#define RUN_STATUS_LED DK_LED1
#define CON_STATUS_LED DK_LED2

#define RUN_LED_BLINK_INTERVAL 1000

static const struct bt_data ad[] = {
  BT_DATA_BYTES(BT_DATA_FLAGS, (BT_LE_AD_GENERAL | BT_LE_AD_NO_BREDR)),
  BT_DATA_BYTES(BT_DATA_UUID128_ALL, BT_UUID_MDS_VAL),
};

static struct bt_conn *mds_conn;
static struct k_work adv_work;

static void bas_work_handler(struct k_work *work);

static K_WORK_DELAYABLE_DEFINE(bas_work, bas_work_handler);

#if defined(CONFIG_BT_SMP)
static void security_changed(struct bt_conn *conn, bt_security_t level, enum bt_security_err err) {
  char addr[BT_ADDR_LE_STR_LEN];

  bt_addr_le_to_str(bt_conn_get_dst(conn), addr, sizeof(addr));

  if (!err) {
    printk("Security changed: %s level %u\n", addr, level);
  } else {
    printk("Security failed: %s level %u err %d %s\n", addr, level, err,
           bt_security_err_to_str(err));
  }

  if (level >= BT_SECURITY_L2) {
    if (!mds_conn) {
      mds_conn = conn;
    }
  }
}
#endif  // defined(CONFIG_BT_SMP)

static void adv_work_handler(struct k_work *work) {
  /* Read the name fresh on every (re)start so a name provisioned over the
   * `bt name` shell command (settings key bt/name, applied on the next
   * boot - see CONFIG_BT_DEVICE_NAME_DYNAMIC) is reflected in the
   * advertising data.
   */
  const char *name = bt_get_name();
  const struct bt_data sd[] = {
    BT_DATA(BT_DATA_NAME_COMPLETE, name, strlen(name)),
  };
  int err = bt_le_adv_start(BT_LE_ADV_CONN_FAST_2, ad, ARRAY_SIZE(ad), sd, ARRAY_SIZE(sd));

  if (err) {
    printk("Advertising failed to start (err %d)\n", err);
    return;
  }

  printk("Advertising successfully started\n");
}

static void advertising_start(void) {
  k_work_submit(&adv_work);
}

static void connected(struct bt_conn *conn, uint8_t conn_err) {
  char addr[BT_ADDR_LE_STR_LEN];

  if (conn_err) {
    printk("Connection failed, err 0x%02x %s\n", conn_err, bt_hci_err_to_str(conn_err));
    return;
  }

  bt_addr_le_to_str(bt_conn_get_dst(conn), addr, sizeof(addr));
  printk("Connected %s\n", addr);

  dk_set_led_on(CON_STATUS_LED);
}

static void disconnected(struct bt_conn *conn, uint8_t reason) {
  printk("Disconnected, reason 0x%02x %s\n", reason, bt_hci_err_to_str(reason));

  dk_set_led_off(CON_STATUS_LED);

  if (conn == mds_conn) {
    mds_conn = NULL;
  }
}

static void recycled_cb(void) {
  printk("Connection object available from previous conn. Disconnect is complete!\n");
  advertising_start();
}

BT_CONN_CB_DEFINE(conn_callbacks) = {
  .connected = connected,
  .disconnected = disconnected,
#if defined(CONFIG_BT_SMP)
  .security_changed = security_changed,
#endif
  .recycled = recycled_cb,
};

#if defined(CONFIG_BT_SMP)
static void pairing_complete(struct bt_conn *conn, bool bonded) {
  char addr[BT_ADDR_LE_STR_LEN];

  bt_addr_le_to_str(bt_conn_get_dst(conn), addr, sizeof(addr));

  printk("Pairing completed: %s, bonded: %d\n", addr, bonded);
}

static void pairing_failed(struct bt_conn *conn, enum bt_security_err reason) {
  char addr[BT_ADDR_LE_STR_LEN];

  bt_addr_le_to_str(bt_conn_get_dst(conn), addr, sizeof(addr));

  printk("Pairing failed conn: %s, reason %d %s\n", addr, reason, bt_security_err_to_str(reason));
}

static struct bt_conn_auth_info_cb conn_auth_info_callbacks = { .pairing_complete =
                                                                  pairing_complete,
                                                                .pairing_failed = pairing_failed };

static void auth_cancel(struct bt_conn *conn) {
  char addr[BT_ADDR_LE_STR_LEN];

  bt_addr_le_to_str(bt_conn_get_dst(conn), addr, sizeof(addr));

  printk("Pairing cancelled: %s\n", addr);
}

static struct bt_conn_auth_cb conn_auth_callbacks = {
  .cancel = auth_cancel,
};
#endif  // defined(CONFIG_BT_SMP)

#if defined(CONFIG_BT_MDS) && defined(CONFIG_BT_SMP)
static bool mds_access_enable(struct bt_conn *conn) {
  if (mds_conn && (conn == mds_conn)) {
    return true;
  }

  return false;
}

static const struct bt_mds_cb mds_cb = {
  .access_enable = mds_access_enable,
};
#endif  // defined(CONFIG_BT_MDS) && defined(CONFIG_BT_SMP)

static void button_handler(uint32_t button_state, uint32_t has_changed) {
  static bool time_measure_start;

  int err;
  uint32_t buttons = button_state & has_changed;

  if (buttons & DK_BTN1_MSK) {
    time_measure_start = !time_measure_start;

    if (time_measure_start) {
      err = MEMFAULT_METRIC_TIMER_START(button_elapsed_time_ms);
      if (err) {
        printk("Failed to start memfault metrics timer: %d\n", err);
      }
    } else {
      err = MEMFAULT_METRIC_TIMER_STOP(button_elapsed_time_ms);
      if (err) {
        printk("Failed to stop memfault metrics: %d\n", err);
      }

      /* Trigger collection of heartbeat data. */
      memfault_metrics_heartbeat_debug_trigger();
    }
  }

  if (has_changed & DK_BTN2_MSK) {
    bool button_state = (buttons & DK_BTN2_MSK) ? 1 : 0;

    MEMFAULT_TRACE_EVENT_WITH_LOG(button_state_changed, "Button state: %u", button_state);

    printk("button_state_changed event has been tracked, button state: %u\n", button_state);
  }

  if (buttons & DK_BTN3_MSK) {
    err = MEMFAULT_METRIC_ADD(button_press_count, 1);
    if (err) {
      printk("Failed to increase button_press_count metric: %d\n", err);
    } else {
      printk("button_press_count metric increased\n");
    }
  }

  if (buttons & DK_BTN4_MSK) {
    volatile uint32_t i;

    printk("Division by zero will now be triggered\n");
#pragma GCC diagnostic push
#pragma GCC diagnostic ignored "-Wdiv-by-zero"
    i = 1 / 0;
#pragma GCC diagnostic pop
    ARG_UNUSED(i);
  }
}

static void bas_notify(void) {
  int err;
  uint8_t battery_level = bt_bas_get_battery_level();

  __ASSERT_NO_MSG(battery_level > 0);

  battery_level--;

  if (battery_level == 0) {
    battery_level = 100U;
  }

  err = MEMFAULT_METRIC_SET_UNSIGNED(battery_soc_pct, battery_level);
  if (err) {
    printk("Failed to set battery_soc_pct memfault metrics (err %d)\n", err);
  }

  bt_bas_set_battery_level(battery_level);
}

static void bas_work_handler(struct k_work *work) {
  bas_notify();
  k_work_reschedule((struct k_work_delayable *)work, K_SECONDS(1));
}

#if defined(CONFIG_MEMFAULT_NCS_DEVICE_ID_RUNTIME)
  #include <hw_id.h>
  #include <memfault_ncs.h>

static void serial_number_init(void) {
  char serial_buf[64] = "unknown";
  int ret = hw_id_get(serial_buf, sizeof(serial_buf));

  if (ret) {
    printk("Failed to get device ID from HW ID (err %d)\n", ret);
    return;
  }
  printk("➡️ Device serial set to: %s\n", serial_buf);

  // Apply the serial number to Memfault
  (void)memfault_ncs_device_id_set(serial_buf, strlen(serial_buf));
}
#endif  // CONFIG_MEMFAULT_NCS_DEVICE_ID_RUNTIME

#if defined(CONFIG_MEMFAULT_MCUMGR_GRP)
  #include "memfault/ports/zephyr/memfault_mcumgr.h"

//! The access-enabled variable is passed as user arg for demonstration purposes
static bool s_memfault_mcumgr_access_allowed = true;
static bool prv_memfault_mgmt_is_access_allowed(void *user_arg) {
  return *(bool *)user_arg;
}

static int cmd_memfault_mcumgr_access(const struct shell *shell_ptr, size_t argc, char **argv) {
  memfault_mcumgr_set_access_callback(prv_memfault_mgmt_is_access_allowed,
                                      &s_memfault_mcumgr_access_allowed);

  if (argc > 1) {
    if (strcmp(argv[1], "1") == 0) {
      s_memfault_mcumgr_access_allowed = true;
    } else if (strcmp(argv[1], "0") == 0) {
      s_memfault_mcumgr_access_allowed = false;
    } else {
      shell_print(shell_ptr, "Usage: memfault-mcumgr-access <1|0>");
      return -EINVAL;
    }
  }

  shell_print(shell_ptr, "Memfault MCUmgr group access is now %s",
              s_memfault_mcumgr_access_allowed ? "ENABLED" : "DISABLED");
  return 0;
}

#endif  // defined(CONFIG_MEMFAULT_MCUMGR_GRP)

SHELL_STATIC_SUBCMD_SET_CREATE(
  sub_config,
#if defined(CONFIG_MEMFAULT_MCUMGR_GRP)
  SHELL_CMD_ARG(memfault_mcumgr_access, NULL,
                "Enable or disable Memfault MCUmgr group access. Usage: "
                "memfault-mcumgr-access <1|0>",
                cmd_memfault_mcumgr_access, 1, 1),
#endif  // defined(CONFIG_MEMFAULT_MCUMGR_GRP)
  SHELL_SUBCMD_SET_END);
SHELL_CMD_REGISTER(config, &sub_config, "Configure the example", NULL);

#if CONFIG_MEMFAULT_APP_CAPTURE_ALL_RAM
// capture *ALL* of ram
const sMfltCoredumpRegion *memfault_platform_coredump_get_regions(
  const sCoredumpCrashInfo *crash_info, size_t *num_regions) {
  static sMfltCoredumpRegion s_regions[] = {
    MEMFAULT_COREDUMP_MEMORY_REGION_INIT(CONFIG_PM_SRAM_BASE, CONFIG_PM_SRAM_SIZE),
  };
  *num_regions = ARRAY_SIZE(s_regions);
  return s_regions;
}
#endif  // CONFIG_MEMFAULT_APP_CAPTURE_ALL_RAM

#define WD_FEED_THREAD_STACK_SIZE 500
// set priority to lowest application thread; shell_uart, where the 'mflt test
// hang' command runs from, uses the same priority by default, so this should
// not preempt it and correctly trip the watchdog
#if CONFIG_SHELL_THREAD_PRIORITY_OVERRIDE
  #error "Watchdog feed thread priority must be lower than shell thread priority"
#endif
#define WD_FEED_THREAD_PRIORITY K_LOWEST_APPLICATION_THREAD_PRIO

static void prv_wd_feed_thread_function(void *arg0, void *arg1, void *arg2) {
  ARG_UNUSED(arg0);
  ARG_UNUSED(arg1);
  ARG_UNUSED(arg2);

  while (1) {
    memfault_software_watchdog_feed();
    k_sleep(K_SECONDS(1));
  }
}
K_THREAD_DEFINE(wd_feed_thread, WD_FEED_THREAD_STACK_SIZE, prv_wd_feed_thread_function, NULL, NULL,
                NULL, WD_FEED_THREAD_PRIORITY, 0, 0);

static void prv_start_watchdog_feed_thread(void) {
  memfault_software_watchdog_enable();
  k_thread_name_set(wd_feed_thread, "wd_feed_thread");
  k_thread_start(wd_feed_thread);
}

int main(void) {
  uint32_t blink_status = 0;
  int err;

  printk(MEMFAULT_BANNER_COLORIZED "\n");
  printk("Memfault Demo Application\n");
  printk("Board: " CONFIG_BOARD "\n");

  prv_start_watchdog_feed_thread();

  err = dk_leds_init();
  if (err) {
    printk("LEDs init failed (err %d)\n", err);
    return 0;
  }

  err = dk_buttons_init(button_handler);
  if (err) {
    printk("Failed to initialize buttons (err %d)\n", err);
    return 0;
  }

#if defined(CONFIG_BT_MDS) && defined(CONFIG_BT_SMP)
  err = bt_mds_cb_register(&mds_cb);
  if (err) {
    printk("Memfault Diagnostic service callback registration failed (err %d)\n", err);
    return 0;
  }
#endif  // defined(CONFIG_BT_MDS) && defined(CONFIG_BT_SMP)

  err = bt_enable(NULL);
  if (err) {
    printk("Bluetooth init failed (err %d)\n", err);
    return 0;
  }

#if defined(CONFIG_BT_SMP)
  err = bt_conn_auth_cb_register(&conn_auth_callbacks);
  if (err) {
    printk("Failed to register authorization callbacks (err %d)\n", err);
    return 0;
  }

  err = bt_conn_auth_info_cb_register(&conn_auth_info_callbacks);
  if (err) {
    printk("Failed to register authorization info callbacks (err %d)\n", err);
    return 0;
  }
#endif  // defined(CONFIG_BT_SMP)

  printk("Bluetooth initialized\n");

  if (IS_ENABLED(CONFIG_SETTINGS)) {
    err = settings_load();
    if (err) {
      printk("Failed to load settings (err %d)\n", err);
      return 0;
    }
#if defined(CONFIG_MEMFAULT_NCS_DEVICE_ID_RUNTIME)
    serial_number_init();
#endif
  }

  k_work_init(&adv_work, adv_work_handler);
  advertising_start();

  k_work_schedule(&bas_work, K_SECONDS(1));

  for (;;) {
    dk_set_led(RUN_STATUS_LED, (++blink_status) % 2);
    k_sleep(K_MSEC(RUN_LED_BLINK_INTERVAL));
  }
}
```

## src/bt_smp_dfu_session.c
```c
//! @file
//!
//! Copyright (c) Memfault, Inc.
//! See LICENSE for details
//!
//! @brief
//! Instrumentation that wraps a Bluetooth SMP (MCUmgr) DFU image upload in a
//! Memfault "session" report (https://mflt.io/session-metrics).
//!
//! What this tracks:
//!  - A `bt_smp` session, started when the phone begins uploading a firmware
//!    image and ended when the upload finishes, fails, or the link drops. The
//!    session automatically records its own duration.
//!  - `bt_smp_bytes_received`: image payload bytes accepted from the phone.
//!  - `bt_smp_image_size`: total image size the phone declared up front.
//!  - `bt_smp_status`: outcome code (see eBtSmpDfuStatus).
//!
//! How it hooks in (no MCUmgr internals are modified):
//!  - The DFU lifecycle is observed through the MCUmgr notification callback API
//!    (MGMT_EVT_OP_IMG_MGMT_DFU_*).
//!  - Memfault event storage on this port is RAM-backed, so a session report is
//!    lost across the reboot into the new image. To give it a chance to reach
//!    the phone (via the Memfault Diagnostic Service) before we reboot, we hook
//!    the MCUmgr reset command (MGMT_EVT_OP_OS_MGMT_RESET) and block there until
//!    the Memfault packetizer drains (or a timeout elapses). That hook runs on
//!    the dedicated MCUmgr SMP work queue, *not* the system work queue that
//!    streams MDS data, so blocking it lets MDS keep pushing while we wait. Once
//!    we return, MCUmgr performs its normal reboot.
//!
//! Note on "bytes sent": only bytes *received* from the phone are tracked. The
//! SMP responses we transmit are tiny acknowledgements, and the BLE SMP
//! transmit path is a set of static functions with no public instrumentation
//! point, so a TX byte count is not practical to collect here.

#include <zephyr/init.h>
#include <zephyr/kernel.h>
#include <zephyr/logging/log.h>
#include <zephyr/sys/atomic.h>

#include "memfault/components.h"
#include "memfault/core/data_packetizer.h"
#include "memfault/metrics/metrics.h"

LOG_MODULE_REGISTER(bt_smp_dfu, LOG_LEVEL_INF);

//! Outcome recorded in the `bt_smp_status` session metric.
typedef enum {
  kBtSmpDfuStatus_Success = 0,       //!< Image accepted for test/confirm.
  kBtSmpDfuStatus_Aborted = -1,      //!< MCUmgr reported the upload stopped.
  kBtSmpDfuStatus_Disconnected = -2, //!< Link dropped while an upload was in flight.
} eBtSmpDfuStatus;

#if defined(CONFIG_MCUMGR_GRP_IMG_STATUS_HOOKS) && \
  defined(CONFIG_MCUMGR_GRP_IMG_UPLOAD_CHECK_HOOK)

  #include <zephyr/bluetooth/conn.h>
  #include <zephyr/mgmt/mcumgr/grp/img_mgmt/img_mgmt.h>
  // <.../mgmt/callbacks.h> transitively provides the MCUmgr event enums, the
  // mgmt_callback API, and struct img_mgmt_upload_check. Include it rather than
  // the per-group <.../grp/*/*_callbacks.h> headers directly: those are not
  // self-contained (they reference macros/groups that callbacks.h defines
  // first), so including them standalone fails to compile.
  #include <zephyr/mgmt/mcumgr/mgmt/callbacks.h>

//! Max time to wait for Memfault data to drain before allowing the reboot.
  #define BT_SMP_DFU_DRAIN_TIMEOUT_MS 8000
//! Grace period after the packetizer empties, to let the final BLE notification
//! make it onto the air before the radio goes down.
  #define BT_SMP_DFU_DRAIN_GRACE_MS 500

//! 1 while a bt_smp session is active. Used to coordinate the (rare) race
//! between the MCUmgr handler context and a BT disconnect callback.
static atomic_t s_dfu_active = ATOMIC_INIT(0);

//! Set when a DFU completes successfully and a reboot into the new image is
//! expected. Consumed by the reset hook so unrelated reboots are never delayed.
static atomic_t s_flush_before_reboot = ATOMIC_INIT(0);

static struct {
  uint32_t bytes_received;
  uint32_t image_size;
} s_dfu;

static void prv_end_session(eBtSmpDfuStatus status);

static void prv_start_session(uint32_t image_size) {
  // A fresh upload (offset 0) while a session is still active means the prior
  // attempt was abandoned without notification. Close it out as aborted before
  // starting clean.
  if (atomic_get(&s_dfu_active)) {
    prv_end_session(kBtSmpDfuStatus_Aborted);
  }

  s_dfu.bytes_received = 0;
  s_dfu.image_size = image_size;

  MEMFAULT_METRICS_SESSION_START(bt_smp);
  atomic_set(&s_dfu_active, 1);

  LOG_INF("bt_smp DFU session started (image size %u bytes)", image_size);
}

static void prv_end_session(eBtSmpDfuStatus status) {
  // Atomically claim the session so a concurrent disconnect + lifecycle event
  // can't end it twice.
  if (!atomic_cas(&s_dfu_active, 1, 0)) {
    return;
  }

  MEMFAULT_METRIC_SESSION_SET_UNSIGNED(bt_smp_bytes_received, bt_smp, s_dfu.bytes_received);
  MEMFAULT_METRIC_SESSION_SET_UNSIGNED(bt_smp_image_size, bt_smp, s_dfu.image_size);
  MEMFAULT_METRIC_SESSION_SET_SIGNED(bt_smp_status, bt_smp, status);

  MEMFAULT_METRICS_SESSION_END(bt_smp);

  LOG_INF("bt_smp DFU session ended: status %d, %u/%u bytes received", (int)status,
          s_dfu.bytes_received, s_dfu.image_size);

  if (status == kBtSmpDfuStatus_Success) {
    // A reboot into the new image is imminent; ask the reset hook to flush the
    // session report to the phone first.
    atomic_set(&s_flush_before_reboot, 1);
  }
}

//! Block until the Memfault packetizer drains (or a timeout elapses).
//!
//! Called from the MCUmgr SMP work queue (the reset command handler). The
//! Memfault Diagnostic Service streams from the *system* work queue, so it keeps
//! pushing chunks to the phone while we sleep here.
static void prv_flush_memfault_data(void) {
  LOG_INF("DFU reset requested; flushing Memfault data to phone before reboot (<= %d ms)",
          BT_SMP_DFU_DRAIN_TIMEOUT_MS);

  const int64_t deadline = k_uptime_get() + BT_SMP_DFU_DRAIN_TIMEOUT_MS;
  while (memfault_packetizer_data_available() && (k_uptime_get() < deadline)) {
    k_sleep(K_MSEC(50));
  }

  const bool drained = !memfault_packetizer_data_available();
  LOG_INF("Memfault drain %s; allowing reboot", drained ? "complete" : "timed out");

  // Let the last notification flush over the air before the radio drops.
  k_sleep(K_MSEC(BT_SMP_DFU_DRAIN_GRACE_MS));
}

static enum mgmt_cb_return prv_img_mgmt_cb(uint32_t event, enum mgmt_cb_return prev_status,
                                           int32_t *rc, uint16_t *group, bool *abort_more,
                                           void *data, size_t data_size) {
  ARG_UNUSED(prev_status);
  ARG_UNUSED(rc);
  ARG_UNUSED(group);
  ARG_UNUSED(abort_more);

  switch (event) {
    case MGMT_EVT_OP_IMG_MGMT_DFU_CHUNK: {
      if ((data == NULL) || (data_size != sizeof(struct img_mgmt_upload_check))) {
        break;
      }
      const struct img_mgmt_upload_check *check = data;
      const struct img_mgmt_upload_req *req = check->req;

      if (req->off == 0) {
        // First (or restarted) chunk. action->size is the validated total image
        // size (req->size is SIZE_MAX when the phone omits it).
        prv_start_session((uint32_t)check->action->size);
      }

      if (atomic_get(&s_dfu_active)) {
        s_dfu.bytes_received += (uint32_t)req->img_data.len;
      }
      break;
    }

    case MGMT_EVT_OP_IMG_MGMT_DFU_PENDING:
    case MGMT_EVT_OP_IMG_MGMT_DFU_CONFIRMED:
      // Image written and marked for test (PENDING) or confirmed: success.
      prv_end_session(kBtSmpDfuStatus_Success);
      break;

    case MGMT_EVT_OP_IMG_MGMT_DFU_STOPPED:
      prv_end_session(kBtSmpDfuStatus_Aborted);
      break;

    default:
      break;
  }

  return MGMT_CB_OK;
}

static struct mgmt_callback s_img_mgmt_cb = {
  .callback = prv_img_mgmt_cb,
  .event_id = MGMT_EVT_OP_IMG_MGMT_DFU_CHUNK | MGMT_EVT_OP_IMG_MGMT_DFU_PENDING |
              MGMT_EVT_OP_IMG_MGMT_DFU_CONFIRMED | MGMT_EVT_OP_IMG_MGMT_DFU_STOPPED,
};

  #if defined(CONFIG_MCUMGR_GRP_OS_RESET_HOOK)
//! Hook the MCUmgr reset command so we can flush the session report to the phone
//! before the device reboots into the freshly uploaded image.
static enum mgmt_cb_return prv_os_mgmt_cb(uint32_t event, enum mgmt_cb_return prev_status,
                                          int32_t *rc, uint16_t *group, bool *abort_more,
                                          void *data, size_t data_size) {
  ARG_UNUSED(prev_status);
  ARG_UNUSED(rc);
  ARG_UNUSED(group);
  ARG_UNUSED(abort_more);
  ARG_UNUSED(data);
  ARG_UNUSED(data_size);

  if ((event == MGMT_EVT_OP_OS_MGMT_RESET) && atomic_cas(&s_flush_before_reboot, 1, 0)) {
    prv_flush_memfault_data();
  }

  // Always allow the reset to proceed.
  return MGMT_CB_OK;
}

static struct mgmt_callback s_os_mgmt_cb = {
  .callback = prv_os_mgmt_cb,
  .event_id = MGMT_EVT_OP_OS_MGMT_RESET,
};
  #endif  // CONFIG_MCUMGR_GRP_OS_RESET_HOOK

//! End an in-flight session if the phone disconnects mid-upload. Zephyr allows
//! multiple BT_CONN_CB_DEFINE registrations, so this composes with the set in
//! main.c.
static void prv_dfu_disconnected(struct bt_conn *conn, uint8_t reason) {
  ARG_UNUSED(conn);
  ARG_UNUSED(reason);

  if (atomic_get(&s_dfu_active)) {
    LOG_WRN("Link dropped mid-DFU; ending bt_smp session as failed");
    prv_end_session(kBtSmpDfuStatus_Disconnected);
  }
}

BT_CONN_CB_DEFINE(bt_smp_dfu_conn_cb) = {
  .disconnected = prv_dfu_disconnected,
};

static int prv_bt_smp_dfu_session_init(void) {
  mgmt_callback_register(&s_img_mgmt_cb);
  #if defined(CONFIG_MCUMGR_GRP_OS_RESET_HOOK)
  mgmt_callback_register(&s_os_mgmt_cb);
  #endif
  LOG_INF("bt_smp DFU session tracking registered");
  return 0;
}

SYS_INIT(prv_bt_smp_dfu_session_init, APPLICATION, CONFIG_APPLICATION_INIT_PRIORITY);

// ---------------------------------------------------------------------------
// Bench-test shell commands. These drive the same code paths a real DFU does,
// so you can validate metric recording and the pre-reboot drain without a phone.
// ---------------------------------------------------------------------------

  #if defined(CONFIG_SHELL)
    #include <stdlib.h>

    #include <zephyr/shell/shell.h>

//! Simulate a complete, successful DFU upload of `image_size` bytes.
static int prv_cmd_sim(const struct shell *sh, size_t argc, char **argv) {
  const uint32_t image_size = (argc > 1) ? (uint32_t)strtoul(argv[1], NULL, 0) : 65536;

  shell_print(sh, "Simulating a successful bt_smp DFU of %u bytes", image_size);

  // Mimic the MCUmgr upload: start on the first chunk, accumulate per chunk.
  prv_start_session(image_size);
  const uint32_t chunk = 244;  // typical SMP-over-BLE payload size
  for (uint32_t off = 0; off < image_size; off += chunk) {
    s_dfu.bytes_received += MIN(chunk, image_size - off);
  }
  prv_end_session(kBtSmpDfuStatus_Success);

  shell_print(sh, "Done. The session report is queued and flush-before-reboot is armed.");
  shell_print(sh, "Inspect it with `mflt metrics_dump` or `mflt export`.");
  return 0;
}

//! End the active session as aborted (starting one first if none is active).
static int prv_cmd_abort(const struct shell *sh, size_t argc, char **argv) {
  ARG_UNUSED(argc);
  ARG_UNUSED(argv);

  if (!atomic_get(&s_dfu_active)) {
    shell_print(sh, "No active session; starting one to simulate a mid-upload abort");
    prv_start_session(65536);
    s_dfu.bytes_received = 1024;
  }
  prv_end_session(kBtSmpDfuStatus_Aborted);
  shell_print(sh, "bt_smp session ended as aborted");
  return 0;
}

//! Exercise the pre-reboot drain logic (logs how long it waits) without
//! actually rebooting.
static int prv_cmd_drain(const struct shell *sh, size_t argc, char **argv) {
  ARG_UNUSED(argc);
  ARG_UNUSED(argv);

  shell_print(sh, "Running the pre-reboot Memfault drain (no reboot will occur)...");
  prv_flush_memfault_data();
  shell_print(sh, "Drain routine returned.");
  return 0;
}

SHELL_STATIC_SUBCMD_SET_CREATE(
  sub_bt_smp,
  SHELL_CMD_ARG(sim, NULL, "Simulate a successful DFU session. Usage: bt_smp sim [image_size_bytes]",
                prv_cmd_sim, 1, 1),
  SHELL_CMD(abort, NULL, "End the active DFU session as aborted (starts one if none active)",
            prv_cmd_abort),
  SHELL_CMD(drain, NULL, "Exercise the pre-reboot Memfault drain logic without rebooting",
            prv_cmd_drain),
  SHELL_SUBCMD_SET_END);
SHELL_CMD_REGISTER(bt_smp, &sub_bt_smp, "Bluetooth SMP DFU session test commands", NULL);
  #endif  // CONFIG_SHELL

#else  // MCUmgr image hooks not enabled

  #warning \
    "bt_smp DFU session tracking is inactive: enable CONFIG_MCUMGR_GRP_IMG_STATUS_HOOKS and " \
    "CONFIG_MCUMGR_GRP_IMG_UPLOAD_CHECK_HOOK (see prj.conf)"

#endif  // CONFIG_MCUMGR_GRP_IMG_STATUS_HOOKS && CONFIG_MCUMGR_GRP_IMG_UPLOAD_CHECK_HOOK
```

## src/shell_commands.c
```c
//! @file
//!
//! Copyright (c) Memfault, Inc.
//! See LICENSE for details
//!
//! Shell commands

#include <stdlib.h>
#include <zephyr/drivers/gpio.h>
#include <zephyr/kernel.h>
// #include <zephyr/pm/device.h>
#include <zephyr/logging/log.h>
#include <zephyr/pm/pm.h>
#include <zephyr/shell/shell.h>
#include <zephyr/sys/poweroff.h>

LOG_MODULE_REGISTER(appshell, LOG_LEVEL_INF);

static const struct gpio_dt_spec sw0 = GPIO_DT_SPEC_GET(DT_ALIAS(sw0), gpios);

// Define a simple shell command
static int cmd_poweroff(const struct shell *shell, size_t argc, char **argv) {
  LOG_INF("Powering off device");
  /* configure sw0 as input, interrupt as level active to allow wake-up */
  int rc = gpio_pin_configure_dt(&sw0, GPIO_INPUT);
  if (rc < 0) {
    LOG_ERR("Could not configure sw0 GPIO (%d)\n", rc);
    return 0;
  }

  rc = gpio_pin_interrupt_configure_dt(&sw0, GPIO_INT_LEVEL_ACTIVE);
  if (rc < 0) {
    LOG_ERR("Could not configure sw0 GPIO interrupt (%d)\n", rc);
    return 0;
  }

  LOG_INF("Entering system off; press sw0 to restart\n");

  // rc = pm_device_action_run(cons, PM_DEVICE_ACTION_SUSPEND);
  // if (rc < 0) {
  // 	printf("Could not suspend console (%d)\n", rc);
  // 	return 0;
  // }

  // if (IS_ENABLED(CONFIG_APP_RETENTION)) {
  // 	/* Update the retained state */
  // 	retained.off_count += 1;
  // 	retained_update();
  // }

  sys_poweroff();
  return 0;
}

SHELL_CMD_REGISTER(poweroff, NULL, "Power off the device", cmd_poweroff);

#if defined(CONFIG_PM)
//! Forces the CPU into PM_STATE_SUSPEND_TO_IDLE for a caller-selected
//! duration, to exercise the "power_suspend_to_idle_sN_time_ms" Memfault
//! metrics (N = substate_id) on demand. Substate 0 has no metric - it isn't
//! implemented in the PM code, so it's never entered.
//!
//! pm_state_force() only applies to the *next* idle entry, so this only
//! guarantees the forced state is used if nothing else wakes the CPU (e.g.
//! other timers, log flushing) before the k_msleep() below completes. For a
//! clean single measurement, keep other activity on the board quiet while
//! testing (e.g. disable periodic Memfault uploads).
static int cmd_pm_suspend_to_idle(const struct shell *shell, size_t argc, char **argv) {
  if (argc < 2) {
    shell_error(shell, "Usage: %s <duration_ms> [substate_id]", argv[0]);
    return -EINVAL;
  }

  const uint32_t duration_ms = (uint32_t)strtoul(argv[1], NULL, 0);
  // substate 2 ("idle_cache_disabled") is the deepest SUSPEND_TO_IDLE
  // substate implemented today on nRF54H/nRF92 (see soc_power.c); substate 1
  // ("idle_cache_retained") is also available. See the board's devicetree
  // "power-states" node for the substates this target actually supports.
  const uint8_t substate_id = (argc > 2) ? (uint8_t)strtoul(argv[2], NULL, 0) : 2;

  const struct pm_state_info info = {
    .state = PM_STATE_SUSPEND_TO_IDLE,
    .substate_id = substate_id,
  };

  if (!pm_state_force(0, &info)) {
    shell_error(shell,
                "Failed to force PM_STATE_SUSPEND_TO_IDLE substate %u - "
                "check the board's devicetree \"power-states\" node",
                substate_id);
    return -EIO;
  }

  shell_print(shell, "Forcing PM_STATE_SUSPEND_TO_IDLE substate %u for %u ms", substate_id,
              duration_ms);
  k_msleep(duration_ms);
  // Substate IDs >= 3 fold into the "s2" metric bucket - see
  // MFLT_PM_METRICS_MAX_SUBSTATES in memfault_platform_power_metrics.c.
  if (substate_id == 0) {
    shell_print(shell, "Done - substate 0 has no metric, no time was recorded");
  } else {
    shell_print(shell, "Done - check the \"power_suspend_to_idle_s%u_time_ms\" Memfault metric",
                MIN(substate_id, 2));
  }

  return 0;
}

SHELL_CMD_ARG_REGISTER(pm_suspend_to_idle, NULL,
                       "Force PM_STATE_SUSPEND_TO_IDLE for a duration in ms: "
                       "pm_suspend_to_idle <ms> [substate_id]",
                       cmd_pm_suspend_to_idle, 2, 1);
#endif  // defined(CONFIG_PM)
```
