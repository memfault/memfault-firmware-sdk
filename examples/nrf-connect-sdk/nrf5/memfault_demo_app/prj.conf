## CMakeLists.txt
```
# SPDX-License-Identifier: Apache-2.0

cmake_minimum_required(VERSION 3.20.0)

# The default board for this example is the nrf52840dk/nrf52840, but can be
# overridden by passing --board=<board> to west or -DBOARD=<board> to cmake
set(BOARD nrf52840dk/nrf52840)

find_package(Zephyr REQUIRED HINTS $ENV{ZEPHYR_BASE})
project(fs_shell)

FILE(GLOB app_sources src/*.c)
target_sources(app PRIVATE
  src/main.c
  src/shell_commands.c
)

zephyr_include_directories(config)

# Normalize dbug + __FILE__ paths to relative locations:
# 1. west workspace
# 2. toolchain install location (applies to paths in cross tool library files)
#
# If debugging from location 1., the west-manifest files should already have the
# correct relative path for GDB to locate them, otherwise the GDB "directory"
# command can be used to tell GDB where to find the source files (also required
# if the cross tool libraries/headers need to be located by GDB)
get_filename_component(WEST_PROJECT_ROOT_PATH
                       "${CMAKE_CURRENT_LIST_DIR}/.."
                       ABSOLUTE)
zephyr_compile_options(
    -ffile-prefix-map=${WEST_PROJECT_ROOT_PATH}=.
    -ffile-prefix-map=${TOOLCHAIN_HOME}=.
    -Wa,--debug-prefix-map=${WEST_PROJECT_ROOT_PATH}=.
)

# If building for nrf54l15dk, add a custom linker fragment for placing the
# noinit section.
if(CONFIG_BOARD_NRF54L15DK)
  zephyr_linker_sources(SECTIONS
    ${CMAKE_CURRENT_SOURCE_DIR}/boards/nrf54l15dk_nrf54l15_cpuapp_noinit.ld
  )
endif()

# Same for nrf54lm20DK
if(CONFIG_BOARD_NRF54LM20DK)
  zephyr_linker_sources(SECTIONS
    ${CMAKE_CURRENT_SOURCE_DIR}/boards/nrf54lm20dk_nrf54lm20a_cpuapp_noinit.ld
  )
endif()
```

## Kconfig
```
menu "MEMFAULT_APP"

# Set Memfault software_version from the VERSION file in the application. This
# is also used by MCUBoot to set CONFIG_MCUBOOT_IMGTOOL_SIGN_VERSION, so the
# MCUBoot image version will match the Memfault-reported version with this
# setting. Note: the Kconfig flag MEMFAULT_NCS_FW_VERSION is defined in the NCS
# repo, here it's just overriding the default string to be set to the desired value.
config MEMFAULT_NCS_FW_VERSION
    default "$(APP_VERSION_TWEAK_STRING)"

config MEMFAULT_APP_CAPTURE_ALL_RAM
    bool "Capture all RAM"
    help
      Capture all RAM regions. This is useful for debugging purposes, but
      will increase the amount of data captured by the Memfault SDK.

# If MEMFAULT_APP_CAPTURE_ALL_RAM is enabled, increase the configured space
# for the Memfault storage partition to accommodate the larger coredump.
#
# This overrides the default setting, which can be found here:
# https://github.com/nrfconnect/sdk-nrf/blob/96f97684565fbf711f1ceb7da061fed0bfe7b60b/modules/memfault-firmware-sdk/Kconfig#L170-L172
#
# Expanded into the template here:
# https://github.com/nrfconnect/sdk-nrf/blob/96f97684565fbf711f1ceb7da061fed0bfe7b60b/subsys/partition_manager/Kconfig.template.partition_size
#
# Keep 'source "Kconfig.zephyr"' at the end of this file so this default takes
# precedence.
if MEMFAULT_NCS_INTERNAL_FLASH_BACKED_COREDUMP
config PM_PARTITION_SIZE_MEMFAULT_STORAGE
    hex "Size of the Memfault storage partition"
    # The default size is set to one page above the total RAM size on the
    # NRF52840 SOC, which provides room for the coredump header and NVIC and CPU
    # registers. This size needs to be flash page-aligned ("minimum eraseable
    # unit").
    default 0x41000 if MEMFAULT_APP_CAPTURE_ALL_RAM
endif
endmenu

source "Kconfig.zephyr"
```

## sample.yaml
```
sample:
  description: Memfault SDK example integration built on top of the Zephyr FS
    shell sample app, with the nRF Connect SDK
  name: Memfault Demo App
```

## west.yml
```
manifest:
  remotes:
    - name: nrf-connect-sdk
      url-base: https://github.com/nrfconnect
  projects:
    - name: nrf
      url: https://github.com/nrfconnect/sdk-nrf
      revision: v3.2.0
      import: true

    # Adding the memfault-firmware-sdk module here overrides the version the nRF
    # Connect SDK would normally import above
    - name: memfault-firmware-sdk
      url: https://github.com/memfault/memfault-firmware-sdk
      path: modules/lib/memfault-firmware-sdk
      revision: master
  self:
    path: memfault_demo_app
```

## prj.conf
```kconfig
# Heap memory is required for the memfault_demo_cli.c
CONFIG_HEAP_MEM_POOL_SIZE=256

CONFIG_MAIN_STACK_SIZE=4096

CONFIG_BT=y
CONFIG_BT_SMP=y
CONFIG_BT_PERIPHERAL=y
CONFIG_BT_DEVICE_NAME="Nordic_Memfault"
CONFIG_BT_PRIVACY=y

CONFIG_BT_BAS=y
CONFIG_BT_MDS=y

CONFIG_BT_CTLR_PHY_2M=y
CONFIG_BT_BUF_ACL_RX_SIZE=251
CONFIG_BT_L2CAP_TX_MTU=247
CONFIG_BT_BUF_ACL_TX_SIZE=251
CONFIG_BT_CTLR_DATA_LENGTH_MAX=251

CONFIG_LOG=y
CONFIG_LOG_PRINTK=n
CONFIG_LOG_DEFAULT_LEVEL=2
CONFIG_LOG_MODE_DEFERRED=y
CONFIG_LOG_MODE_OVERFLOW=y
CONFIG_LOG_BACKEND_RTT=n

CONFIG_SHELL=y
CONFIG_SENSOR_SHELL=n
CONFIG_DK_LIBRARY=y

# Heap memory is required for the memfault_demo_cli.c


CONFIG_MEMFAULT=y
CONFIG_MEMFAULT_SHELL=y
CONFIG_MEMFAULT_LOGGING_ENABLE=y
CONFIG_MEMFAULT_LOG_LEVEL_INF=y

CONFIG_MEMFAULT_NCS_BT_METRICS=y

CONFIG_MEMFAULT_SYSTEM_TIME_SOURCE_CUSTOM=y

# Enable bonding
CONFIG_BT_SETTINGS=y
CONFIG_FLASH=y
CONFIG_FLASH_PAGE_LAYOUT=y
CONFIG_FLASH_MAP=y

# Enable OTA updates
CONFIG_NCS_SAMPLE_MCUMGR_BT_OTA_DFU=y

# Device Information Service (required for OTA)
CONFIG_BT_DIS=y
CONFIG_BT_DIS_SERIAL_NUMBER=y
CONFIG_BT_DIS_HW_REV=y
CONFIG_BT_DIS_SW_REV=y
CONFIG_BT_DIS_FW_REV=y

# Fill in with a Memfault Project Key
CONFIG_MEMFAULT_NCS_PROJECT_KEY="xxxxxxxxxxxxxxxxxxxxxxxxxxxxxxxx"

# Memfault firmware identification
CONFIG_MEMFAULT_NCS_FW_VERSION_STATIC=y

# Set the Memfault device serial at runtime (loaded from settings bt/dis/serial)
CONFIG_MEMFAULT_NCS_DEVICE_ID_RUNTIME=y
# Enable BT DIS (Device Information Service) settings storage
CONFIG_BT_DIS_SETTINGS=y
# Enable HW ID library to get device ID from UID
CONFIG_HW_ID_LIBRARY=y
CONFIG_HW_ID_LIBRARY_SOURCE_DEVICE_ID=y

# Enable more fields in the nRF Connect Device Manager app view
CONFIG_MCUMGR_GRP_OS_INFO=y

# Setting shell, useful for testing
CONFIG_SETTINGS_SHELL=y

# Settings runtime enables applying settings immediately without reboot
CONFIG_SETTINGS_RUNTIME=y

# Enable Flash and Bootloader components for flash-backed coredump storage
CONFIG_BOOTLOADER_MCUBOOT=y
CONFIG_MCUBOOT_IMG_MANAGER=y
CONFIG_IMG_MANAGER=y
CONFIG_STREAM_FLASH=y

CONFIG_WATCHDOG=y

# Enable Zephyr runtime asserts
CONFIG_ASSERT=y

# For testing poweroff mode, enable GPIO + poweroff subsystems
CONFIG_GPIO=y
CONFIG_POWEROFF=y
```

## boards/nrf54l15dk_nrf54l15_cpuapp.conf
```kconfig
# Use RRAM internal storage implementation instead of flash-based
CONFIG_MEMFAULT_NCS_INTERNAL_FLASH_BACKED_COREDUMP=n
CONFIG_MEMFAULT_COREDUMP_STORAGE_RRAM=y

# Place the noinit objects into a custom section.
CONFIG_MEMFAULT_REBOOT_TRACKING_REGION="memfault_noinit.memfault_reboot_info"
```

## boards/nrf5340dk_nrf5340_cpuapp_ns.overlay
```dts
/*
    Reserve a special region of RAM for saving Memfault noinit data.
*/
/ {
    reserved-memory {
        sram0_shared: memory@20070000 {
            // unfortunately these operators are unsupported for memory units
            // reg = <0x20070000 (DT_SIZE_K(64) - 0x100)>;
            reg = < 0x20070000 0xff00 >;
            phandle = < 0xf >;
        };

        memfaultnoinit: memfaultnoinit@2007ff00 {
            compatible = "zephyr,memory-region";
            reg = <0x2007ff00 0x100>;
            zephyr,memory-region = "MEMFAULTNOINIT";
        };
    };
};
```

## boards/nrf54lm20dk_nrf54lm20a_cpuapp.overlay
```dts
/* Reserve a fixed retained SRAM window for Memfault reboot tracking and
 * RAM-backed coredumps without shifting the main RAM placement.
 */

/ {
	memfault_noinit_sram: memfault_noinit_sram@2007f000 {
		compatible = "zephyr,memory-region", "mmio-sram";
		reg = <0x2007f000 0xc00>;
		zephyr,memory-region = "MemfaultNoInit";
		status = "okay";
	};
};

&cpuapp_sram {
	reg = <0x20000000 0x7f000>;
	ranges = <0x0 0x20000000 0x7f000>;
};
```

## src/main.c
```c
/*
 * Copyright (c) 2022 Nordic Semiconductor ASA
 *
 * SPDX-License-Identifier: LicenseRef-Nordic-5-Clause
 */

#include <bluetooth/services/mds.h>
#include <dk_buttons_and_leds.h>
#include <hw_id.h>
#include <memfault/components.h>
#include <memfault/core/trace_event.h>
#include <memfault/metrics/metrics.h>
#include <memfault/ports/watchdog.h>
#include <memfault_ncs.h>
#include <zephyr/bluetooth/bluetooth.h>
#include <zephyr/bluetooth/conn.h>
#include <zephyr/bluetooth/hci.h>
#include <zephyr/bluetooth/services/bas.h>
#include <zephyr/kernel.h>
#include <zephyr/settings/settings.h>
#include <zephyr/shell/shell.h>

#define DEVICE_NAME CONFIG_BT_DEVICE_NAME
#define DEVICE_NAME_LEN (sizeof(DEVICE_NAME) - 1)

#define RUN_STATUS_LED DK_LED1
#define CON_STATUS_LED DK_LED2

#define RUN_LED_BLINK_INTERVAL 1000

static const struct bt_data ad[] = {
  BT_DATA_BYTES(BT_DATA_FLAGS, (BT_LE_AD_GENERAL | BT_LE_AD_NO_BREDR)),
  BT_DATA_BYTES(BT_DATA_UUID128_ALL, BT_UUID_MDS_VAL),
};

static const struct bt_data sd[] = {
  BT_DATA(BT_DATA_NAME_COMPLETE, DEVICE_NAME, DEVICE_NAME_LEN),
};

static struct bt_conn *mds_conn;
static struct k_work adv_work;

static void bas_work_handler(struct k_work *work);

static K_WORK_DELAYABLE_DEFINE(bas_work, bas_work_handler);

static void security_changed(struct bt_conn *conn, bt_security_t level, enum bt_security_err err) {
  char addr[BT_ADDR_LE_STR_LEN];

  bt_addr_le_to_str(bt_conn_get_dst(conn), addr, sizeof(addr));

  if (!err) {
    printk("Security changed: %s level %u\n", addr, level);
  } else {
    printk("Security failed: %s level %u err %d %s\n", addr, level, err,
           bt_security_err_to_str(err));
  }

  if (level >= BT_SECURITY_L2) {
    if (!mds_conn) {
      mds_conn = conn;
    }
  }
}

static void adv_work_handler(struct k_work *work) {
  int err = bt_le_adv_start(BT_LE_ADV_CONN_FAST_2, ad, ARRAY_SIZE(ad), sd, ARRAY_SIZE(sd));

  if (err) {
    printk("Advertising failed to start (err %d)\n", err);
    return;
  }

  printk("Advertising successfully started\n");
}

static void advertising_start(void) {
  k_work_submit(&adv_work);
}

static void connected(struct bt_conn *conn, uint8_t conn_err) {
  char addr[BT_ADDR_LE_STR_LEN];

  if (conn_err) {
    printk("Connection failed, err 0x%02x %s\n", conn_err, bt_hci_err_to_str(conn_err));
    return;
  }

  bt_addr_le_to_str(bt_conn_get_dst(conn), addr, sizeof(addr));
  printk("Connected %s\n", addr);

  dk_set_led_on(CON_STATUS_LED);
}

static void disconnected(struct bt_conn *conn, uint8_t reason) {
  printk("Disconnected, reason 0x%02x %s\n", reason, bt_hci_err_to_str(reason));

  dk_set_led_off(CON_STATUS_LED);

  if (conn == mds_conn) {
    mds_conn = NULL;
  }
}

static void recycled_cb(void) {
  printk("Connection object available from previous conn. Disconnect is complete!\n");
  advertising_start();
}

BT_CONN_CB_DEFINE(conn_callbacks) = {
  .connected = connected,
  .disconnected = disconnected,
  .security_changed = security_changed,
  .recycled = recycled_cb,
};

static void pairing_complete(struct bt_conn *conn, bool bonded) {
  char addr[BT_ADDR_LE_STR_LEN];

  bt_addr_le_to_str(bt_conn_get_dst(conn), addr, sizeof(addr));

  printk("Pairing completed: %s, bonded: %d\n", addr, bonded);
}

static void pairing_failed(struct bt_conn *conn, enum bt_security_err reason) {
  char addr[BT_ADDR_LE_STR_LEN];

  bt_addr_le_to_str(bt_conn_get_dst(conn), addr, sizeof(addr));

  printk("Pairing failed conn: %s, reason %d %s\n", addr, reason, bt_security_err_to_str(reason));
}

static struct bt_conn_auth_info_cb conn_auth_info_callbacks = { .pairing_complete =
                                                                  pairing_complete,
                                                                .pairing_failed = pairing_failed };

static void auth_cancel(struct bt_conn *conn) {
  char addr[BT_ADDR_LE_STR_LEN];

  bt_addr_le_to_str(bt_conn_get_dst(conn), addr, sizeof(addr));

  printk("Pairing cancelled: %s\n", addr);
}

static struct bt_conn_auth_cb conn_auth_callbacks = {
  .cancel = auth_cancel,
};

static bool mds_access_enable(struct bt_conn *conn) {
  if (mds_conn && (conn == mds_conn)) {
    return true;
  }

  return false;
}

static const struct bt_mds_cb mds_cb = {
  .access_enable = mds_access_enable,
};

static void button_handler(uint32_t button_state, uint32_t has_changed) {
  static bool time_measure_start;

  int err;
  uint32_t buttons = button_state & has_changed;

  if (buttons & DK_BTN1_MSK) {
    time_measure_start = !time_measure_start;

    if (time_measure_start) {
      err = MEMFAULT_METRIC_TIMER_START(button_elapsed_time_ms);
      if (err) {
        printk("Failed to start memfault metrics timer: %d\n", err);
      }
    } else {
      err = MEMFAULT_METRIC_TIMER_STOP(button_elapsed_time_ms);
      if (err) {
        printk("Failed to stop memfault metrics: %d\n", err);
      }

      /* Trigger collection of heartbeat data. */
      memfault_metrics_heartbeat_debug_trigger();
    }
  }

  if (has_changed & DK_BTN2_MSK) {
    bool button_state = (buttons & DK_BTN2_MSK) ? 1 : 0;

    MEMFAULT_TRACE_EVENT_WITH_LOG(button_state_changed, "Button state: %u", button_state);

    printk("button_state_changed event has been tracked, button state: %u\n", button_state);
  }

  if (buttons & DK_BTN3_MSK) {
    err = MEMFAULT_METRIC_ADD(button_press_count, 1);
    if (err) {
      printk("Failed to increase button_press_count metric: %d\n", err);
    } else {
      printk("button_press_count metric increased\n");
    }
  }

  if (buttons & DK_BTN4_MSK) {
    volatile uint32_t i;

    printk("Division by zero will now be triggered\n");
#pragma GCC diagnostic push
#pragma GCC diagnostic ignored "-Wdiv-by-zero"
    i = 1 / 0;
#pragma GCC diagnostic pop
    ARG_UNUSED(i);
  }
}

static void bas_notify(void) {
  int err;
  uint8_t battery_level = bt_bas_get_battery_level();

  __ASSERT_NO_MSG(battery_level > 0);

  battery_level--;

  if (battery_level == 0) {
    battery_level = 100U;
  }

  err = MEMFAULT_METRIC_SET_UNSIGNED(battery_soc_pct, battery_level);
  if (err) {
    printk("Failed to set battery_soc_pct memfault metrics (err %d)\n", err);
  }

  bt_bas_set_battery_level(battery_level);
}

static void bas_work_handler(struct k_work *work) {
  bas_notify();
  k_work_reschedule((struct k_work_delayable *)work, K_SECONDS(1));
}

#define SERIAL_NUMBER_SETTING_KEY "bt/dis/serial"

static void serial_number_init(void) {
  int err = settings_get_val_len(SERIAL_NUMBER_SETTING_KEY);

  printk("Checked for existing serial number in settings, length %d\n", err);

  /* Check if the serial number is already set */
  char serial_buf[64] = "unknown";
  int serial_len = settings_load_one(SERIAL_NUMBER_SETTING_KEY, serial_buf, sizeof(serial_buf));

  if (serial_len == 0) {
    printk("📥 Writing new device serial number to " SERIAL_NUMBER_SETTING_KEY " from HW info\n");
    int ret = hw_id_get(serial_buf, sizeof(serial_buf));

    if (ret) {
      printk("Failed to get device ID from HW ID (err %d)\n", ret);
      return;
    }
    serial_len = strlen(serial_buf);
    settings_save_one(SERIAL_NUMBER_SETTING_KEY, serial_buf, serial_len);
    ret = settings_runtime_set(SERIAL_NUMBER_SETTING_KEY, serial_buf, serial_len);
    if (ret) {
      printk("Failed to set device serial number in settings runtime (err %d)\n", ret);
    }
  } else {
    printk("📤 Loaded serial number from settings\n");
  }

  printk("➡️ Device serial set to: %s\n", serial_buf);

  // Apply the serial number to Memfault
  (void)memfault_ncs_device_id_set(serial_buf, serial_len);
}

// Shell command to set Bluetooth DIS + Memfault serial number
static int cmd_set_bt_serial(const struct shell *shell_ptr, size_t argc, char *argv[]) {
  if (argc != 2) {
    shell_print(shell_ptr, "Usage: set-bt-serial <serial_number>");
    return -EINVAL;
  }

  const char *serial_number = argv[1];

  int ret = settings_save_one(SERIAL_NUMBER_SETTING_KEY, serial_number, strlen(serial_number));
  if (ret) {
    shell_print(shell_ptr, "Error: Failed to save serial number to settings (err %d)", ret);
    return ret;
  }
  ret = settings_runtime_set(SERIAL_NUMBER_SETTING_KEY, serial_number, strlen(serial_number));
  if (ret) {
    shell_print(shell_ptr, "Error: Failed to set serial number in settings runtime (err %d)", ret);
    return ret;
  }
  (void)memfault_ncs_device_id_set(serial_number, strlen(serial_number));

  shell_print(shell_ptr, "Bluetooth serial number saved to settings successfully");
  return 0;
}

SHELL_STATIC_SUBCMD_SET_CREATE(sub_config,
                               SHELL_CMD_ARG(set_bt_serial, NULL,
                                             "Set Bluetooth serial number in settings",
                                             cmd_set_bt_serial, 2, 0),
                               SHELL_SUBCMD_SET_END);
SHELL_CMD_REGISTER(config, &sub_config, "Configure the example", NULL);

#if CONFIG_MEMFAULT_APP_CAPTURE_ALL_RAM
// capture *ALL* of ram
const sMfltCoredumpRegion *memfault_platform_coredump_get_regions(
  const sCoredumpCrashInfo *crash_info, size_t *num_regions) {
  static sMfltCoredumpRegion s_regions[] = {
    MEMFAULT_COREDUMP_MEMORY_REGION_INIT(CONFIG_PM_SRAM_BASE, CONFIG_PM_SRAM_SIZE),
  };
  *num_regions = ARRAY_SIZE(s_regions);
  return s_regions;
}
#endif  // CONFIG_MEMFAULT_APP_CAPTURE_ALL_RAM

#define WD_FEED_THREAD_STACK_SIZE 500
// set priority to lowest application thread; shell_uart, where the 'mflt test
// hang' command runs from, uses the same priority by default, so this should
// not preempt it and correctly trip the watchdog
#if CONFIG_SHELL_THREAD_PRIORITY_OVERRIDE
  #error "Watchdog feed thread priority must be lower than shell thread priority"
#endif
#define WD_FEED_THREAD_PRIORITY K_LOWEST_APPLICATION_THREAD_PRIO

static void prv_wd_feed_thread_function(void *arg0, void *arg1, void *arg2) {
  ARG_UNUSED(arg0);
  ARG_UNUSED(arg1);
  ARG_UNUSED(arg2);

  while (1) {
    memfault_software_watchdog_feed();
    k_sleep(K_SECONDS(1));
  }
}
K_THREAD_DEFINE(wd_feed_thread, WD_FEED_THREAD_STACK_SIZE, prv_wd_feed_thread_function, NULL, NULL,
                NULL, WD_FEED_THREAD_PRIORITY, 0, 0);

static void prv_start_watchdog_feed_thread(void) {
  memfault_software_watchdog_enable();
  k_thread_name_set(wd_feed_thread, "wd_feed_thread");
  k_thread_start(wd_feed_thread);
}

int main(void) {
  uint32_t blink_status = 0;
  int err;

  printk(MEMFAULT_BANNER_COLORIZED "\n");
  printk("Memfault Demo Application\n");
  printk("Board: " CONFIG_BOARD "\n");

  prv_start_watchdog_feed_thread();

  err = dk_leds_init();
  if (err) {
    printk("LEDs init failed (err %d)\n", err);
    return 0;
  }

  err = dk_buttons_init(button_handler);
  if (err) {
    printk("Failed to initialize buttons (err %d)\n", err);
    return 0;
  }

  err = bt_mds_cb_register(&mds_cb);
  if (err) {
    printk("Memfault Diagnostic service callback registration failed (err %d)\n", err);
    return 0;
  }

  err = bt_enable(NULL);
  if (err) {
    printk("Bluetooth init failed (err %d)\n", err);
    return 0;
  }

  err = bt_conn_auth_cb_register(&conn_auth_callbacks);
  if (err) {
    printk("Failed to register authorization callbacks (err %d)\n", err);
    return 0;
  }

  err = bt_conn_auth_info_cb_register(&conn_auth_info_callbacks);
  if (err) {
    printk("Failed to register authorization info callbacks (err %d)\n", err);
    return 0;
  }

  printk("Bluetooth initialized\n");

  if (IS_ENABLED(CONFIG_SETTINGS)) {
    err = settings_load();
    if (err) {
      printk("Failed to load settings (err %d)\n", err);
      return 0;
    }
    serial_number_init();
  }

  k_work_init(&adv_work, adv_work_handler);
  advertising_start();

  k_work_schedule(&bas_work, K_SECONDS(1));

  for (;;) {
    dk_set_led(RUN_STATUS_LED, (++blink_status) % 2);
    k_sleep(K_MSEC(RUN_LED_BLINK_INTERVAL));
  }
}
```

## src/shell_commands.c
```c
//! @file
//!
//! Copyright (c) Memfault, Inc.
//! See LICENSE for details
//!
//! Shell commands

#include <zephyr/drivers/gpio.h>
#include <zephyr/kernel.h>
// #include <zephyr/pm/device.h>
#include <zephyr/logging/log.h>
#include <zephyr/shell/shell.h>
#include <zephyr/sys/poweroff.h>

LOG_MODULE_REGISTER(appshell, LOG_LEVEL_INF);

static const struct gpio_dt_spec sw0 = GPIO_DT_SPEC_GET(DT_ALIAS(sw0), gpios);

// Define a simple shell command
static int cmd_poweroff(const struct shell *shell, size_t argc, char **argv) {
  LOG_INF("Powering off device");
  /* configure sw0 as input, interrupt as level active to allow wake-up */
  int rc = gpio_pin_configure_dt(&sw0, GPIO_INPUT);
  if (rc < 0) {
    LOG_ERR("Could not configure sw0 GPIO (%d)\n", rc);
    return 0;
  }

  rc = gpio_pin_interrupt_configure_dt(&sw0, GPIO_INT_LEVEL_ACTIVE);
  if (rc < 0) {
    LOG_ERR("Could not configure sw0 GPIO interrupt (%d)\n", rc);
    return 0;
  }

  LOG_INF("Entering system off; press sw0 to restart\n");

  // rc = pm_device_action_run(cons, PM_DEVICE_ACTION_SUSPEND);
  // if (rc < 0) {
  // 	printf("Could not suspend console (%d)\n", rc);
  // 	return 0;
  // }

  // if (IS_ENABLED(CONFIG_APP_RETENTION)) {
  // 	/* Update the retained state */
  // 	retained.off_count += 1;
  // 	retained_update();
  // }

  sys_poweroff();
  return 0;
}

SHELL_CMD_REGISTER(poweroff, NULL, "Power off the device", cmd_poweroff);
```
