## CMakeLists.txt
```
# SPDX-License-Identifier: Apache-2.0

cmake_minimum_required(VERSION 3.13.1)

list(APPEND ZEPHYR_EXTRA_MODULES $ENV{ZEPHYR_BASE}/../modules/memfault-firmware-sdk/ports/nrf-connect-sdk)
set(spm_CONF_FILE ${CMAKE_CURRENT_SOURCE_DIR}/spm.conf)

find_package(Zephyr HINTS $ENV{ZEPHYR_BASE})
project(hello_world)

target_sources(app PRIVATE src/main.c)
zephyr_include_directories(config)
```

## west.yml
```
manifest:
  remotes:
    - name: nrf-connect-sdk
      url-base: https://github.com/nrfconnect
  projects:
    - name: sdk-nrf
      remote: nrf-connect-sdk
      path: nrf
      revision: v1.4.0
      import: true
    - name: memfault-firmware-sdk
      url: https://github.com/memfault/memfault-firmware-sdk
      path: modules/memfault-firmware-sdk
      revision: master
  self:
    path: memfault_demo_app
    import: submanifests
```

## prj.conf
```kconfig
# project specific configuration settings

CONFIG_BSD_LIBRARY=y
CONFIG_BSD_LIBRARY_SYS_INIT=n

CONFIG_NETWORKING=y
CONFIG_NET_SOCKETS=y
CONFIG_NET_SOCKETS_POSIX_NAMES=y
CONFIG_NET_NATIVE=n

CONFIG_HEAP_MEM_POOL_SIZE=4096
CONFIG_MAIN_STACK_SIZE=4096

CONFIG_MODEM_KEY_MGMT=y
CONFIG_LTE_LINK_CONTROL=y

CONFIG_SHELL=y
CONFIG_SHELL_BACKEND_SERIAL=y

CONFIG_NET_LOG=y

CONFIG_NET_SOCKETS_OFFLOAD=y
CONFIG_MEMFAULT=y
CONFIG_MEMFAULT_ROOT_CERT_STORAGE_NRF9160_MODEM=y
CONFIG_MEMFAULT_HTTP_ENABLE=y
CONFIG_MEMFAULT_HTTP_PERIODIC_UPLOAD=y

# Required for logging to work from crash
CONFIG_LOG_IMMEDIATE=y

# Required for logging backends to work as expected
CONFIG_LOG=y
CONFIG_LOG_BACKEND_UART=y

# Enable Bootloader so OTA updates can be performed
CONFIG_BOOTLOADER_MCUBOOT=y
CONFIG_MCUBOOT_IMG_MANAGER=y

# The subsystems we need so OTA payloads can be written to
# flash and updated by MCUBoot
CONFIG_DFU_TARGET=y
CONFIG_DFU_TARGET_MCUBOOT=y
CONFIG_IMG_MANAGER=y
CONFIG_FLASH=y
CONFIG_IMG_ERASE_PROGRESSIVELY=y

# For Memfault FOTA, we will use the FOTA_DOWNLOAD API's
# from the nRF Connect SDK which depends on the DOWNLOAD_CLIENT
CONFIG_FOTA_DOWNLOAD=y
CONFIG_DOWNLOAD_CLIENT=y

# Enable printing of file download progress to console
CONFIG_FOTA_DOWNLOAD_PROGRESS_EVT=y

# Off by default since a small patch is needed to nrf in order to enable
# as of the latest SDK release (nRF Connect SDK v1.4.x)
#  https://mflt.io/nrf-fota
#
# CONFIG_MEMFAULT_FOTA=y
# CONFIG_DOWNLOAD_CLIENT_MAX_FILENAME_SIZE=400
# CONFIG_DOWNLOAD_CLIENT_STACK_SIZE=1600
#
# Note: Can optionally be changed to =y to implement
# a custom event handler for FOTA events
# CONFIG_MEMFAULT_FOTA_DOWNLOAD_CALLBACK_CUSTOM=n
```

## spm.conf
```kconfig
# Configuration settings from the nRF Secure Partition Manager (SPM) example
CONFIG_IS_SPM=y
CONFIG_FW_INFO=y

# We don't enable Memfault on the Secure Partition Image
CONFIG_MEMFAULT=n
```

## src/main.c
```c
//! @file
//!
//! Copyright (c) Memfault, Inc.
//! See License.txt for details
//!
//! Entry point to Memfault Radio. In this file you will find:
//!  1. Implementation for memfault_platform_get_device_info()
//!    - The firmware version uses the Memfault integration with the GNU Build ID
//!      (https://mflt.io/gnu-build-id) to guarantee dev builds always have a unique
//!      version
//!    - Looks up the IMEI and uses that as the device_serial
//!  2. g_mflt_http_client_config dependency which needs to be filled in with your Project API Key
//!  3. A call to install the Root Certs used by Memfault on the nRF91 modem
//!     (memfault_nrfconnect_port_install_root_certs())
//!  4. Start of the LTE modem & AT interface

#include <string.h>

#include <zephyr.h>
#include <sys/printk.h>

#include <modem/lte_lc.h>
#include <modem/at_cmd.h>
#include <modem/at_notif.h>
#include <modem/modem_key_mgmt.h>
#include <modem/bsdlib.h>

#include "memfault/core/build_info.h"
#include "memfault/core/compiler.h"
#include "memfault/core/math.h"
#include "memfault/core/platform/device_info.h"
#include "memfault/http/http_client.h"
#include "memfault/nrfconnect_port/http.h"

#if CONFIG_DFU_TARGET_MCUBOOT
#include <dfu/mcuboot.h>
#endif

sMfltHttpClientConfig g_mflt_http_client_config = {
  .api_key = "<YOUR API KEY HERE>",
};

static char s_fw_version[16]="1.0.0+";

#define IMEI_LEN 15
static char s_device_serial[IMEI_LEN + 1 /* '\0' */];

void memfault_platform_get_device_info(sMemfaultDeviceInfo *info) {
  static bool s_init = false;

  if (!s_init) {
    const size_t version_len = strlen(s_fw_version);
    // We will use 6 characters of the build id to make our versions unique and
    // identifiable between releases
    const size_t build_id_chars = 6 + 1 /* '\0' */;

    const size_t build_id_num_chars =
        MEMFAULT_MIN(build_id_chars, sizeof(s_fw_version) - version_len - 1);

    memfault_build_id_get_string(&s_fw_version[version_len], build_id_num_chars);
    s_init = true;
  }

  // platform specific version information
  *info = (sMemfaultDeviceInfo) {
    .device_serial = s_device_serial,
    .software_type = "nrf91ns-fw",
    .software_version = s_fw_version,
    .hardware_version = "proto",
  };
}

static int query_modem(const char *cmd, char *buf, size_t buf_len) {
  enum at_cmd_state at_state;
  int ret = at_cmd_write(cmd, buf, buf_len, &at_state);

  if (ret != 0) {
    printk("at_cmd_write [%s] error:%d, at_state: %d",
            cmd, ret, at_state);
  }

  return ret;
}

static void prv_init_device_info(void) {
  // we'll use the IMEI as the device serial
  char imei_buf[IMEI_LEN + 2 /* for \r\n */ + 1 /* \0 */];
  if (query_modem("AT+CGSN", imei_buf, sizeof(imei_buf)) != 0) {
    strcat(s_device_serial, "Unknown");
    return;
  }

  imei_buf[IMEI_LEN] = '\0';
  strcat(s_device_serial, imei_buf);

  printk("Device Serial: %s\n", s_device_serial);
}

void main(void) {
  printk("Memfault Demo App Started!\n");

#if CONFIG_DFU_TARGET_MCUBOOT
  if (!boot_is_img_confirmed()) {
    // Mark the ota image as installed so we don't revert
    printk("Confirming OTA update\n");
    boot_write_img_confirmed();
  }
#endif

  int err = bsdlib_init();
  if (err) {
    printk("Failed to initialize bsdlib!");
    return;
  }

  err = at_cmd_init();
  if (err) {
    printk("Failed to initialize AT commands, err %d\n", err);
    return;
  }

  err = at_notif_init();
  if (err) {
    printk("Failed to initialize AT notifications, err %d\n", err);
    return;
  }

  // requires AT modem interface to be up
  prv_init_device_info();

  // Note: We must provision certs prior to connecting to the LTE network
  // in order to use them
  err = memfault_nrfconnect_port_install_root_certs();
  if (err) {
    return;
  }

  printk("Waiting for network...\n");
  err = lte_lc_init_and_connect();
  if (err) {
    printk("Failed to connect to the LTE network, err %d\n", err);
    return;
  }
  printk("OK\n");
}
```
