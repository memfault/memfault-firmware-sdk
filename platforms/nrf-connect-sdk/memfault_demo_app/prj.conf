## CMakeLists.txt
```
# SPDX-License-Identifier: Apache-2.0

cmake_minimum_required(VERSION 3.13.1)

list(APPEND ZEPHYR_EXTRA_MODULES $ENV{ZEPHYR_BASE}/../modules/memfault-firmware-sdk/ports/nrf-connect-sdk)

find_package(Zephyr HINTS $ENV{ZEPHYR_BASE})
project(hello_world)

target_sources(app PRIVATE src/main.c)
zephyr_include_directories(config)
```

## west.yml
```
manifest:
  remotes:
    - name: nrf-connect-sdk
      url-base: https://github.com/nrfconnect
  projects:
    - name: sdk-nrf
      remote: nrf-connect-sdk
      path: nrf
      revision: v1.3.0
      import: true
    - name: memfault-firmware-sdk
      url: https://github.com/memfault/memfault-firmware-sdk
      path: modules/memfault-firmware-sdk
      revision: master
  self:
    path: memfault_demo_app
    import: submanifests
```

## prj.conf
```kconfig
# project specific configuration settings
```

## src/main.c
```c
//! @file
//!
//! Copyright (c) Memfault, Inc.
//! See License.txt for details

#include <zephyr.h>
#include <sys/printk.h>

#include "memfault/core/platform/device_info.h"

void memfault_platform_get_device_info(sMemfaultDeviceInfo *info) {
  // platform specific version information
  *info = (sMemfaultDeviceInfo) {
    .device_serial = "DEMOSERIAL",
    .software_type = "main-fw",
    .software_version = "1.0.0-dev1",
    .hardware_version = "proto-hardware",
  };
}

void main(void) {
  printk("Hello World! %s\n", CONFIG_BOARD);
}
```
