## CMakeLists.txt
```
cmake_minimum_required(VERSION 3.13.1)

include($ENV{ZEPHYR_BASE}/cmake/app/boilerplate.cmake NO_POLICY_SCOPE)
project(memfault_demo_app)

zephyr_include_directories(config)
target_sources(app PRIVATE src/main.c)
```

## sample.yaml
```
sample:
  description: Memfault SDK example integration built on top of Hello
    World Sample App
  name: Memfault Demo App
```

## prj.conf
```kconfig
# General config
CONFIG_NEWLIB_LIBC=y

# Networking config
CONFIG_NETWORKING=y
CONFIG_NET_IPV4=y
CONFIG_NET_IPV6=y
CONFIG_NET_TCP=y
CONFIG_NET_SOCKETS=y
CONFIG_NET_SOCKETS_POSIX_NAMES=y

CONFIG_DNS_RESOLVER=y
CONFIG_DNS_SERVER_IP_ADDRESSES=y
CONFIG_DNS_SERVER1="8.8.8.8"

# Network debug config
CONFIG_NET_LOG=y

CONFIG_SHELL=y
# Networking Config:
CONFIG_NETWORKING=y
CONFIG_NET_IPV4=y
CONFIG_NET_IPV6=n
CONFIG_NET_SOCKETS=y

# Enable SimpleLink WiFi Driver and Socket Offload
CONFIG_WIFI=y
CONFIG_WIFI=y
CONFIG_WIFI_LOG_LEVEL_ERR=y
CONFIG_NET_L2_WIFI_SHELL=y

# Debugging
CONFIG_NET_LOG=y
CONFIG_WIFI_LOG_LEVEL_DBG=n
CONFIG_DEBUG=y
CONFIG_ASSERT=y

CONFIG_SHELL_STACK_SIZE=4096
CONFIG_MAIN_STACK_SIZE=4096
CONFIG_MBEDTLS=y
CONFIG_MBEDTLS_BUILTIN=y
CONFIG_MBEDTLS_ENABLE_HEAP=y
CONFIG_MBEDTLS_HEAP_SIZE=34000
CONFIG_MBEDTLS_SSL_MAX_CONTENT_LEN=4096
CONFIG_NET_SOCKETS_SOCKOPT_TLS=y

# Must match the number of certs being added with tls_credential_add
CONFIG_TLS_MAX_CREDENTIALS_NUMBER=5

# The maximum number of certs to be used when resolving root of trust on a socket
CONFIG_NET_SOCKETS_TLS_MAX_CREDENTIALS=5

CONFIG_MBEDTLS_USER_CONFIG_ENABLE=y
CONFIG_MBEDTLS_USER_CONFIG_FILE="memfault-mbedtls.conf"

CONFIG_REBOOT=y
CONFIG_OPENOCD_SUPPORT=y
CONFIG_INIT_STACKS=y
CONFIG_MPU_STACK_GUARD=y

CONFIG_MEMFAULT=y
CONFIG_MEMFAULT_HTTP_ENABLE=y
CONFIG_MEMFAULT_LOGGING_ENABLE=y

CONFIG_MEMFAULT_HTTP_PERIODIC_UPLOAD=y
CONFIG_MEMFAULT_HTTP_PERIODIC_UPLOAD_INTERVAL_SECS=30
CONFIG_SYSTEM_WORKQUEUE_STACK_SIZE=4096
CONFIG_MEMFAULT_LOGGING_RAM_SIZE=512

CONFIG_HEAP_MEM_POOL_SIZE=1024
```

## src/main.c
```c
//! @file
//!
//! Copyright (c) Memfault, Inc.
//! See License.txt for details

#include <zephyr.h>

#include <string.h>

// Product-specific Memfault dependencies
#include "memfault/core/build_info.h"
#include "memfault/core/math.h"
#include "memfault/core/platform/device_info.h"
#include "memfault/http/http_client.h"
#include "memfault/ports/zephyr/http.h"

sMfltHttpClientConfig g_mflt_http_client_config = {
  .api_key = "<YOUR API KEY HERE>",
};


static char s_fw_version[16]="1.0.0+";

void memfault_platform_get_device_info(sMemfaultDeviceInfo *info) {
  static bool s_init = false;

  if (!s_init) {
    const size_t version_len = strlen(s_fw_version);
    // We will use 6 characters of the build id to make our versions unique and
    // identifiable between releases
    const size_t build_id_chars = 6 + 1 /* '\0' */;

    const size_t build_id_num_chars =
        MEMFAULT_MIN(build_id_chars, sizeof(s_fw_version) - version_len - 1);

    memfault_build_id_get_string(&s_fw_version[version_len], build_id_num_chars);
    s_init = true;
  }

  *info = (sMemfaultDeviceInfo) {
    .device_serial = "DEMOSERIAL",
    .software_type = "zephyr-main",
    .software_version = s_fw_version,
    .hardware_version = "disco_l475_iot1",
  };
}

void main(void) {
  printk("Memfault Demo App! Board %s\n", CONFIG_BOARD);
  memfault_zephyr_port_install_root_certs();
}
```
